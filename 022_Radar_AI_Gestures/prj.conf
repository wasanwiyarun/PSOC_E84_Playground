## CMakeLists.txt
```
cmake_minimum_required(VERSION 3.20.0)
find_package(Zephyr REQUIRED HINTS $ENV{ZEPHYR_BASE})
project(psoc_e84_radar_ai LANGUAGES C CXX)
set(RADAR_REFERENCE_ROOT "${CMAKE_CURRENT_SOURCE_DIR}/../../Temp/Radar" CACHE PATH "Licensed reference project")
set(MTB_TFLM_ROOT "${CMAKE_CURRENT_SOURCE_DIR}/../../Temp/mtb_shared/ml-tflite-micro/release-v3.4.0" CACHE PATH "Infineon TFLM 3.4.0")
set(TFLM_INCLUDE ${MTB_TFLM_ROOT}/COMPONENT_ML_TFLM/include)
set(TFLM_LIB ${MTB_TFLM_ROOT}/COMPONENT_ML_TFLM/COMPONENT_U55/TOOLCHAIN_GCC_ARM/libtensorflow-microlite.a)
if(NOT EXISTS ${TFLM_LIB})
  message(FATAL_ERROR "Install ml-tflite-micro 3.4.0 through the reference project's Library Manager; see README.md")
endif()
file(SHA256 ${TFLM_LIB} TFLM_SHA256)
if(NOT TFLM_SHA256 STREQUAL "c05c9ddc87932a13f6ec6a24490e8734127a43246404d0cbd6a707a202447d5c")
  message(FATAL_ERROR "Unexpected TFLM archive: review its ABI, headers and model compatibility before changing the pin")
endif()
set(GENERATED ${CMAKE_CURRENT_BINARY_DIR}/model-generated)
execute_process(COMMAND ${PYTHON_EXECUTABLE} ${CMAKE_CURRENT_SOURCE_DIR}/prepare_model.py
  ${RADAR_REFERENCE_ROOT} ${GENERATED} COMMAND_ERROR_IS_FATAL ANY)
set_property(DIRECTORY APPEND PROPERTY CMAKE_CONFIGURE_DEPENDS prepare_model.py
  ${RADAR_REFERENCE_ROOT}/proj_cm55/model/model.c ${RADAR_REFERENCE_ROOT}/proj_cm55/model/model.h)
set(IFX_PDL ${ZEPHYR_HAL_INFINEON_MODULE_DIR}/mtb-dsl-pse8xxgp/pdl)
set(RADAR_VENDOR ${CMAKE_CURRENT_SOURCE_DIR}/../021_Radar_BGT60TR13C/vendor/bgt60trxx)
target_sources(app PRIVATE src/main.c src/radar.c src/ai_runtime.cpp
  ${GENERATED}/model.c ${RADAR_VENDOR}/xensiv_bgt60trxx.c ${IFX_PDL}/drivers/source/cy_scb_spi.c)
target_include_directories(app PRIVATE src ${GENERATED} ${RADAR_VENDOR})
target_include_directories(app SYSTEM PRIVATE ${TFLM_INCLUDE} ${TFLM_INCLUDE}/flatbuffers/include
  ${TFLM_INCLUDE}/gemmlowp ${TFLM_INCLUDE}/ruy)
target_compile_definitions(app PRIVATE PSE846GPS2DBZC4A COMPONENT_55500
  COMPONENT_55500A1 COMPONENT_CM55 COMPONENT_CM55_0 COMPONENT_NON_SECURE_DEVICE
  COMPONENT_ML_TFLM COMPONENT_ML_FLOAT32 TF_LITE_STATIC_MEMORY)
# Generated FFT intentionally uses double constants; retain its arithmetic.
set_source_files_properties(${GENERATED}/model.c PROPERTIES COMPILE_OPTIONS "-O3;-Wno-double-promotion")
# Match the supplied archive's enum ABI, only inside the C++ TFLM boundary.
set_source_files_properties(src/ai_runtime.cpp PROPERTIES COMPILE_OPTIONS "-O3;-fshort-enums")
zephyr_link_libraries(${TFLM_LIB})
```

## prj.conf
```kconfig
CONFIG_CONSOLE=y
CONFIG_UART_CONSOLE=y
CONFIG_PRINTK=y
CONFIG_ASSERT=y
CONFIG_CRC=y
CONFIG_MAIN_STACK_SIZE=16384
CONFIG_CPP=y
CONFIG_STD_CPP17=y
CONFIG_GLIBCXX_LIBCPP=y
CONFIG_CMSIS_NN=y
CONFIG_CMSIS_NN_ACTIVATION=y
CONFIG_CMSIS_NN_BASICMATH=y
CONFIG_CMSIS_NN_CONVOLUTION=y
CONFIG_CMSIS_NN_FULLYCONNECTED=y
CONFIG_CMSIS_NN_SOFTMAX=y
CONFIG_CMSIS_NN_LSTM=y
```

## src/main.c
```c
#include <zephyr/kernel.h>
#include <zephyr/init.h>
#include <zephyr/drivers/uart.h>
#include <zephyr/sys/atomic.h>
#include <zephyr/sys/crc.h>
#include <cy_sysclk.h>
#include <errno.h>
#include <math.h>
#include <stdlib.h>
#include <string.h>
#include "model.h"
#include "ai_runtime.h"
#include "radar.h"

#define WINDOW_FRAMES 10U
#define MAX_WINDOWS 1200U
#define SELF_WINDOWS 3U
static const char *const labels[] = IMAI_DATA_OUT_SYMBOLS;
static const struct device *uart = DEVICE_DT_GET(DT_CHOSEN(zephyr_console));
static uint16_t capture[WINDOW_FRAMES * RADAR_SAMPLES];
static bool capture_valid;
static int radar_ret, model_ret;
static unsigned arena_used, requested;
static char run_token[33];
static atomic_t active, stopping, completed;
K_MUTEX_DEFINE(console_lock);
K_SEM_DEFINE(work, 0, 1);

/* Match the secure-core clock setup reused from Example 017. */
static int clock_metadata_init(void)
{ Cy_SysClk_EcoSetFrequency(17203200U); return 0; }
SYS_INIT(clock_metadata_init, PRE_KERNEL_1, 0);

static int reset_model(void)
{
    model_ret = IMAI_init();
    arena_used = model_ret ? 0 : ai_runtime_arena_used();
    return model_ret;
}

static void scores(const char *kind, const char *token, unsigned window,
                   unsigned pass, const float output[3], uint32_t capture_us,
                   uint32_t infer_us, uint32_t crc)
{
    unsigned best = 0;
    uint32_t bits[3];
    memcpy(bits, output, sizeof(bits));
    for (unsigned i = 1; i < 3; ++i) if (output[i] > output[best]) best = i;
    printk("DATA AI %s token=%s window=%u pass=%u class=%s p0=%u p1=%u p2=%u bits=%08x,%08x,%08x capture_us=%u infer_us=%u crc=%08x\n",
           kind, token, window, pass, labels[best],
           (unsigned)(output[0] * 1000000), (unsigned)(output[1] * 1000000),
           (unsigned)(output[2] * 1000000), bits[0], bits[1], bits[2], capture_us, infer_us, crc);
}

/* Preserve the exact generated FFT and 10-frame queue contract. */
static int predict(const uint16_t *raw, float output[3])
{
    float input[RADAR_SAMPLES];
    for (unsigned frame = 0; frame < WINDOW_FRAMES; ++frame) {
        for (unsigned i = 0; i < RADAR_SAMPLES; ++i) input[i] = raw[frame * RADAR_SAMPLES + i];
        int ret = IMAI_enqueue(input);
        if (ret) return ret;
        ret = IMAI_dequeue(output);
        if (frame + 1 < WINDOW_FRAMES) {
            if (ret != IMAI_RET_NODATA) return -EPROTO;
        } else if (ret) return ret;
    }
    return 0;
}

static void inference_worker(void *a, void *b, void *c)
{
    ARG_UNUSED(a); ARG_UNUSED(b); ARG_UNUSED(c);
    for (;;) {
        k_sem_take(&work, K_FOREVER);
        k_mutex_lock(&console_lock, K_FOREVER);
        int ret = reset_model();
        k_mutex_unlock(&console_lock);
        unsigned windows = 0;
        int64_t begin = k_uptime_get();
        if (!ret) {
            ret = radar_stream_start();
            k_mutex_lock(&console_lock, K_FOREVER);
            radar_ret = ret;
            k_mutex_unlock(&console_lock);
        }
        while (!ret && !atomic_get(&stopping) && windows < requested) {
            struct radar_result acquisition;
            capture_valid = false;
            ret = radar_stream_read(WINDOW_FRAMES, capture, &acquisition);
            if (ret) {
                k_mutex_lock(&console_lock, K_FOREVER);
                radar_ret = ret;
                k_mutex_unlock(&console_lock);
                break;
            }
            float output[3];
            uint32_t start = k_cycle_get_32();
            ret = predict(capture, output);
            uint32_t infer_us = k_cyc_to_us_floor32(k_cycle_get_32() - start);
            k_mutex_lock(&console_lock, K_FOREVER);
            if (ret) model_ret = ret;
            else {
                capture_valid = true;
                scores("RESULT", run_token, windows, 0, output, acquisition.elapsed_us, infer_us,
                       crc32_ieee((const uint8_t *)capture, sizeof(capture)));
                atomic_set(&completed, ++windows);
            }
            k_mutex_unlock(&console_lock);
        }
        int stop_ret = radar_stream_stop();
        if (!ret) ret = stop_ret;
        k_mutex_lock(&console_lock, K_FOREVER);
        if (stop_ret) radar_ret = stop_ret;
        printk("%s AI DONE token=%s ret=%d windows=%u frames=%u elapsed_ms=%lld stopped=%u rf=off\n",
               ret ? "FAIL" : "OK", run_token, ret, windows, windows * WINDOW_FRAMES,
               (long long)(k_uptime_get() - begin), !!atomic_get(&stopping));
        atomic_clear(&active);
        k_mutex_unlock(&console_lock);
    }
}
K_THREAD_DEFINE(ai_worker, 16384, inference_worker, NULL, NULL, NULL, 5, 0, 0);

/* Deterministic ADC fixture, not gesture training data. Checks the real
 * FFT/window/model path and exact reproducibility after reset, without RF. */
static int selftest(const char *token)
{
    float first[SELF_WINDOWS][3], output[3];
    capture_valid = false;
    for (unsigned pass = 0; pass < 2; ++pass) {
        int ret = reset_model();
        if (ret) return ret;
        float invalid[650] = {NAN};
        if (ai_runtime_run(invalid, 650, output, 3) != IMAI_RET_ERROR ||
            ai_runtime_run(invalid, 649, output, 3) != IMAI_RET_ERROR) return -EPROTO;
        for (unsigned window = 0; window < SELF_WINDOWS; ++window) {
            for (unsigned f = 0; f < WINDOW_FRAMES; ++f)
                for (unsigned i = 0; i < RADAR_SAMPLES; ++i)
                    capture[f * RADAR_SAMPLES + i] = 1024 +
                        (((window * WINDOW_FRAMES + f) * 37 + i * 53 + (i * i) % 97) % 2048);
            uint32_t start = k_cycle_get_32();
            ret = predict(capture, output);
            if (ret) return ret;
            if (!pass) memcpy(first[window], output, sizeof(output));
            else if (memcmp(first[window], output, sizeof(output))) return -EBADMSG;
            scores("SELF", token, window, pass, output, 0,
                   k_cyc_to_us_floor32(k_cycle_get_32() - start),
                   crc32_ieee((const uint8_t *)capture, sizeof(capture)));
        }
    }
    return reset_model();
}

static bool valid_token(const char *s)
{
    size_t n = strlen(s);
    if (!n || n > 32) return false;
    for (size_t i = 0; i < n; ++i)
        if (!((s[i] >= 'a' && s[i] <= 'z') || (s[i] >= 'A' && s[i] <= 'Z') ||
              (s[i] >= '0' && s[i] <= '9') || s[i] == '-' || s[i] == '_')) return false;
    return true;
}

/* Under console_lock; live acquisition and inference run on ai_worker. */
static void command(char *line)
{
    char *args[5], *save;
    unsigned argc = 0;
    for (char *s = strtok_r(line, " \t", &save); s; s = strtok_r(NULL, " \t", &save)) {
        if (argc == ARRAY_SIZE(args)) { printk("FAIL AI COMMAND\n"); return; }
        args[argc++] = s;
    }
    if (argc < 3 || strcmp(args[0], "ai")) { printk("FAIL AI COMMAND\n"); return; }
    const char *cmd = args[1], *token = args[argc - 1];
    if (!valid_token(token)) { printk("FAIL AI TOKEN\n"); return; }
    if (argc == 3 && (!strcmp(cmd, "info") || !strcmp(cmd, "status"))) {
        printk("%s AI INFO token=%s chapter=022 model=850a926a-3fd3-4acd-9280-478d7a438955 classes=unlabelled,Circle,Push samples=128 frames_per_window=10 adc_bits=12 engine=TFLM_CPU_FLOAT32 arena=%u radar_ret=%d model_ret=%d active=%u windows=%u max_windows=%u\n",
               radar_ret || model_ret ? "FAIL" : "OK", token, arena_used, radar_ret, model_ret,
               !!atomic_get(&active), (unsigned)atomic_get(&completed), MAX_WINDOWS);
        return;
    }
    if (argc == 3 && !strcmp(cmd, "stop")) {
        atomic_set(&stopping, 1);
        printk("OK AI STOP token=%s active=%u\n", token, !!atomic_get(&active));
        return;
    }
    if (atomic_get(&active)) { printk("FAIL AI BUSY token=%s\n", token); return; }
    if (argc == 3 && !strcmp(cmd, "reset")) {
        capture_valid = false;
        radar_ret = radar_init();
        reset_model();
        atomic_clear(&completed);
        printk("%s AI RESET token=%s radar_ret=%d model_ret=%d\n",
               radar_ret || model_ret ? "FAIL" : "OK", token, radar_ret, model_ret);
        return;
    }
    if (argc == 3 && !strcmp(cmd, "selftest")) {
        int ret = selftest(token);
        model_ret = ret;
        printk("%s AI SELFTEST token=%s ret=%d windows=6 repeat_exact=%u warmup_checked=1 guards_checked=1 rf=off\n",
               ret ? "FAIL" : "OK", token, ret, !ret);
        return;
    }
    if (argc == 3 && !strcmp(cmd, "dump")) {
        if (!capture_valid) { printk("FAIL AI NO_CAPTURE token=%s\n", token); return; }
        for (unsigned frame = 0; frame < WINDOW_FRAMES; ++frame) {
            printk("DATA AI RAW token=%s frame=%u raw=", token, frame);
            for (unsigned i = 0; i < RADAR_SAMPLES; ++i) printk("%03x", capture[frame * RADAR_SAMPLES + i]);
            printk("\n");
        }
        printk("OK AI DUMP token=%s frames=10 crc=%08x\n", token,
               crc32_ieee((const uint8_t *)capture, sizeof(capture)));
        return;
    }
    if ((argc == 4 && !strcmp(cmd, "run")) || (argc == 3 && !strcmp(cmd, "start"))) {
        unsigned long n = MAX_WINDOWS;
        if (argc == 4) {
            char *end;
            n = strtoul(args[2], &end, 10);
            if (!*args[2] || *end || args[2][0] == '-' || args[2][0] == '+' || !n || n > MAX_WINDOWS) {
                printk("FAIL AI ARGUMENT token=%s\n", token); return;
            }
        }
        if (radar_ret || model_ret) { printk("FAIL AI NOT_READY token=%s\n", token); return; }
        requested = n;
        strcpy(run_token, token);
        capture_valid = false;
        atomic_clear(&stopping);
        atomic_clear(&completed);
        atomic_set(&active, 1);
        printk("OK AI START token=%s requested=%u\n", token, requested);
        k_sem_give(&work);
        return;
    }
    printk("FAIL AI COMMAND token=%s\n", token);
}

int main(void)
{
    printk("RADAR_AI BOOT chapter=022\n");
    radar_ret = radar_init();
    reset_model();
    printk("%s AI INITIALIZATION_%s chapter=022 radar_ret=%d model_ret=%d arena=%u rf=off\n",
           radar_ret || model_ret ? "FAIL" : "OK", radar_ret || model_ret ? "FAILED" : "SUCCESS",
           radar_ret, model_ret, arena_used);
    printk("AI READY commands=info,status,selftest,run,start,stop,dump,reset uart=115200\n");
    char line[128]; unsigned used = 0; bool overflow = false;
    for (;;) {
        unsigned char c;
        while (!uart_poll_in(uart, &c)) {
            if (c == '\r' || c == '\n') {
                k_mutex_lock(&console_lock, K_FOREVER);
                if (overflow) printk("FAIL AI COMMAND_TOO_LONG\n");
                else if (used) { line[used] = 0; command(line); }
                k_mutex_unlock(&console_lock);
                used = 0; overflow = false;
            } else if (used < sizeof(line) - 1 && ((c >= 32 && c < 127) || c == '\t')) line[used++] = c;
            else overflow = true;
        }
        k_msleep(1);
    }
}
```

## src/ai_runtime.cpp
```c
/* Checked CPU-only TFLM adapter for the reference float32 model.
 * No NPU initialization, RTOS shim, dynamic allocation or fake predictions. */
#include "ai_runtime.h"
#include <cmath>
#include <cstring>
#include <new>
#include <cstdarg>
#include <zephyr/sys/printk.h>
#include "tensorflow/lite/micro/micro_interpreter.h"
#include "tensorflow/lite/micro/micro_mutable_op_resolver.h"
#include "tensorflow/lite/schema/schema_generated.h"

static tflite::MicroMutableOpResolver<6> resolver;
alignas(tflite::MicroInterpreter) static unsigned char storage[sizeof(tflite::MicroInterpreter)];
static tflite::MicroInterpreter *interpreter;
static bool registered;

extern "C" void DebugLog(const char *message) { printk("TFLM %s", message); }
void MicroPrintf(const char *format, ...)
{
    va_list args;
    va_start(args, format);
    vprintk(format, args);
    va_end(args);
    printk("\n");
}

int ai_runtime_init(const void *data, size_t size, void *arena, size_t arena_size)
{
    ai_runtime_deinit();
    flatbuffers::Verifier verifier(static_cast<const uint8_t *>(data), size);
    if (!tflite::VerifyModelBuffer(verifier)) return -2;
    auto model = tflite::GetModel(data);
    if (model->version() != 3) return -2;
    if (!registered) {
        if (resolver.AddConv2D() != kTfLiteOk || resolver.AddFullyConnected() != kTfLiteOk ||
            resolver.AddMean() != kTfLiteOk || resolver.AddReshape() != kTfLiteOk ||
            resolver.AddSoftmax() != kTfLiteOk || resolver.AddUnidirectionalSequenceLSTM() != kTfLiteOk)
            return -2;
        registered = true;
    }
    memset(arena, 0, arena_size);
    interpreter = new (storage) tflite::MicroInterpreter(model, resolver,
        static_cast<uint8_t *>(arena), arena_size);
    if (interpreter->AllocateTensors() != kTfLiteOk ||
        interpreter->inputs_size() != 1 || interpreter->outputs_size() != 1) goto fail;
    if (interpreter->input(0)->type != kTfLiteFloat32 || interpreter->output(0)->type != kTfLiteFloat32 ||
        interpreter->input(0)->bytes != 650 * sizeof(float) ||
        interpreter->output(0)->bytes != 3 * sizeof(float)) goto fail;
    return 0;
fail:
    ai_runtime_deinit();
    return -2;
}

int ai_runtime_run(const float *input, int inputs, float *output, int outputs)
{
    if (!interpreter || !input || !output || inputs != 650 || outputs != 3) return -2;
    for (int i = 0; i < inputs; ++i) if (!std::isfinite(input[i])) return -2;
    memcpy(interpreter->input(0)->data.f, input, inputs * sizeof(float));
    if (interpreter->Invoke() != kTfLiteOk) return -2;
    const float *scores = interpreter->output(0)->data.f;
    float sum = 0;
    for (int i = 0; i < outputs; ++i) {
        if (!std::isfinite(scores[i]) || scores[i] < 0 || scores[i] > 1) return -2;
        sum += scores[i];
    }
    if (fabsf(sum - 1) > 0.001f) return -2;
    memcpy(output, scores, outputs * sizeof(float));
    return 0;
}

void ai_runtime_deinit(void)
{
    if (interpreter) interpreter->~MicroInterpreter();
    interpreter = nullptr;
}
size_t ai_runtime_arena_used(void) { return interpreter ? interpreter->arena_used_bytes() : 0; }
```

## src/ai_runtime.h
```c
#pragma once
#include <stddef.h>
#ifdef __cplusplus
extern "C" {
#endif
int ai_runtime_init(const void *model, size_t size, void *arena, size_t arena_size);
int ai_runtime_run(const float *input, int inputs, float *output, int outputs);
void ai_runtime_deinit(void);
size_t ai_runtime_arena_used(void);
#ifdef __cplusplus
}
#endif
```

## src/radar.c
```c
/* Chapter-local Zephyr/PDL port. Board wiring follows Temp/Radar's AI BSP.
 * SCB3 is not enabled as a Zephyr device; this module exclusively owns it.
 * Bounded polling keeps register and 12-bit FIFO phases under one manual CS.
 */
#include <zephyr/kernel.h>
#include <zephyr/sys/byteorder.h>
#include <cy_pdl.h>
#include <errno.h>
#include <string.h>
#include "radar.h"
#include "xensiv_bgt60trxx.h"
#include "xensiv_bgt60trxx_platform.h"

static xensiv_bgt60trxx_t radar;
static cy_stc_scb_spi_context_t context;
static bool ready;
static bool streaming;
static uint32_t spi_hz;
static int iface;
/* P0 numerical register settings from Temp/Radar/proj_cm55/radar_settings.h:
 * 61.020099..61.479903 GHz, RX1, 128 samples/chirp, 1 chirp/frame,
 * 2.352941 MS/s, 5.00407 ms/frame. Continuous FIFO port derived from 021. */
static const uint32_t settings[]={
    0x011e8270,0x03088210,0x09e967fd,0x0b0805b4,0x0d1027ff,0x0f010700,
    0x11000000,0x13000000,0x15000000,0x17000be0,0x19000000,0x1b000000,
    0x1d000000,0x1f000b60,0x21103c51,0x231ff41f,0x25006f7b,0x2d000490,
    0x3b000480,0x49000480,0x57000480,0x5911be0e,0x5b44c40a,0x5d000000,
    0x5f787e1e,0x61f5208a,0x630000a4,0x65000252,0x67000080,0x69000000,
    0x6b000000,0x6d000000,0x6f093910,0x7f000100,0x8f000100,0x9f000100,
    0xad000000,0xb7000000
};

void xensiv_bgt60trxx_platform_rst_set(const void *p,bool high)
{ ARG_UNUSED(p); Cy_GPIO_Write(GPIO_PRT20,7,high); }
void xensiv_bgt60trxx_platform_spi_cs_set(const void *p,bool high)
{ ARG_UNUSED(p); Cy_GPIO_Write(GPIO_PRT21,7,high); }
void xensiv_bgt60trxx_platform_delay(uint32_t ms) { k_msleep(ms); }
uint32_t xensiv_bgt60trxx_platform_word_reverse(uint32_t word) { return sys_cpu_to_be32(word); }
void xensiv_bgt60trxx_platform_assert(bool expr) { __ASSERT_NO_MSG(expr); }

static int transfer(const uint8_t *tx,uint8_t *rx,uint16_t *fifo,uint32_t count,unsigned bits)
{
    CY_REG32_CLR_SET(SCB_TX_CTRL(SCB3),SCB_TX_CTRL_DATA_WIDTH,bits-1U);
    CY_REG32_CLR_SET(SCB_RX_CTRL(SCB3),SCB_RX_CTRL_DATA_WIDTH,bits-1U);
    Cy_SCB_SetByteMode(SCB3,bits==8);
    Cy_SCB_SPI_ClearRxFifo(SCB3);
    int64_t deadline=k_uptime_get()+20;
    for(uint32_t i=0;i<count;i++) {
        Cy_SCB_SPI_Write(SCB3,tx?tx[i]:0xffffU);
        while(!Cy_SCB_SPI_GetNumInRxFifo(SCB3)) {
            if(k_uptime_get()>=deadline) goto timeout;
        }
        uint32_t v=Cy_SCB_SPI_Read(SCB3);
        if(rx) rx[i]=(uint8_t)v;
        if(fifo) fifo[i]=(uint16_t)v;
    }
    while(Cy_SCB_SPI_IsBusBusy(SCB3)) if(k_uptime_get()>=deadline) goto timeout;
    return XENSIV_BGT60TRXX_STATUS_OK;
timeout:
    Cy_GPIO_Write(GPIO_PRT21,7,1);
    Cy_SCB_SPI_Disable(SCB3,&context);
    Cy_SCB_SPI_ClearTxFifo(SCB3); Cy_SCB_SPI_ClearRxFifo(SCB3);
    Cy_SCB_SPI_Enable(SCB3); ready=false;
    return XENSIV_BGT60TRXX_STATUS_COM_ERROR;
}
int32_t xensiv_bgt60trxx_platform_spi_transfer(void *p,uint8_t *tx,uint8_t *rx,uint32_t len)
{ ARG_UNUSED(p); return transfer(tx,rx,NULL,len,8); }
int32_t xensiv_bgt60trxx_platform_spi_fifo_read(void *p,uint16_t *rx,uint32_t len)
{ ARG_UNUSED(p); return transfer(NULL,NULL,rx,len,12); }

uint32_t radar_spi_hz(void) { return spi_hz; }
int radar_id(uint32_t *id)
{ return ready?xensiv_bgt60trxx_get_reg(&radar,XENSIV_BGT60TRXX_REG_CHIP_ID,id):-ENODEV; }

int radar_init(void)
{
    ready=false;
    streaming=false;
    printk("RADAR INIT stage=pins\n");
    Cy_GPIO_Pin_FastInit(GPIO_PRT21,7,CY_GPIO_DM_STRONG_IN_OFF,1,HSIOM_SEL_GPIO);
    Cy_GPIO_Pin_FastInit(GPIO_PRT20,7,CY_GPIO_DM_STRONG_IN_OFF,1,HSIOM_SEL_GPIO);
    Cy_GPIO_Pin_FastInit(GPIO_PRT20,3,CY_GPIO_DM_PULLDOWN,0,HSIOM_SEL_GPIO);
    Cy_GPIO_Pin_FastInit(GPIO_PRT21,4,CY_GPIO_DM_HIGHZ,1,P21_4_SCB3_SPI_MISO);
    Cy_GPIO_Pin_FastInit(GPIO_PRT21,5,CY_GPIO_DM_STRONG_IN_OFF,1,P21_5_SCB3_SPI_MOSI);
    Cy_GPIO_Pin_FastInit(GPIO_PRT21,6,CY_GPIO_DM_STRONG_IN_OFF,0,P21_6_SCB3_SPI_CLK);
    Cy_GPIO_SetDriveSel(GPIO_PRT21,5,CY_GPIO_DRIVE_1_8);
    Cy_GPIO_SetDriveSel(GPIO_PRT21,6,CY_GPIO_DRIVE_1_8);
    Cy_SCB_SPI_Disable(SCB3,&context);
    printk("RADAR INIT stage=clock\n");
    /* Same valid divider index as the reference BSP (group has indices 0..4). */
    if(Cy_SysClk_PeriPclkDisableDivider(PCLK_SCB3_CLOCK_SCB_EN,CY_SYSCLK_DIV_8_BIT,1)!=CY_SYSCLK_SUCCESS ||
       Cy_SysClk_PeriPclkSetDivider(PCLK_SCB3_CLOCK_SCB_EN,CY_SYSCLK_DIV_8_BIT,1,3)!=CY_SYSCLK_SUCCESS ||
       Cy_SysClk_PeriPclkAssignDivider(PCLK_SCB3_CLOCK_SCB_EN,CY_SYSCLK_DIV_8_BIT,1)!=CY_SYSCLK_SUCCESS ||
       Cy_SysClk_PeriPclkEnableDivider(PCLK_SCB3_CLOCK_SCB_EN,CY_SYSCLK_DIV_8_BIT,1)!=CY_SYSCLK_SUCCESS) return -EIO;
    spi_hz=Cy_SysClk_PeriPclkGetFrequency(PCLK_SCB3_CLOCK_SCB_EN,CY_SYSCLK_DIV_8_BIT,1)/4;
    printk("RADAR INIT stage=spi hz=%u\n",spi_hz);
    const cy_stc_scb_spi_config_t config={
        .spiMode=CY_SCB_SPI_MASTER,.subMode=CY_SCB_SPI_MOTOROLA,
        .sclkMode=CY_SCB_SPI_CPHA0_CPOL0,.oversample=4,
        .rxDataWidth=8,.txDataWidth=8,.enableMsbFirst=true,
        .enableMisoLateSample=true
    };
    if(Cy_SCB_SPI_Init(SCB3,&config,&context)!=CY_SCB_SPI_SUCCESS) return -EIO;
    Cy_SCB_SPI_SetActiveSlaveSelect(SCB3,CY_SCB_SPI_SLAVE_SELECT1);
    Cy_SCB_SPI_Enable(SCB3);
    radar.iface=&iface;
    printk("RADAR INIT stage=reset\n");
    xensiv_bgt60trxx_hard_reset(&radar);
    int ret=xensiv_bgt60trxx_init(&radar,&iface,false);
    printk("RADAR INIT stage=identity ret=%d\n",ret);
    if(!ret && xensiv_bgt60trxx_get_device(&radar)!=XENSIV_DEVICE_BGT60TR13C) ret=-ENODEV;
    if(!ret) ret=xensiv_bgt60trxx_config(&radar,settings,ARRAY_SIZE(settings));
    if(!ret) ret=xensiv_bgt60trxx_set_fifo_limit(&radar,RADAR_SAMPLES);
    ready=ret==0;
    return ret;
}

static int stream_error(int ret)
{
    /* Even if SPI is broken, hardware reset stops the RF transmitter. */
    xensiv_bgt60trxx_hard_reset(&radar);
    ready=false;
    streaming=false;
    return ret;
}

int radar_stream_start(void)
{
    if(!ready) return -ENODEV;
    if(streaming) return -EBUSY;
    int ret=xensiv_bgt60trxx_start_frame(&radar,false);
    if(!ret) ret=xensiv_bgt60trxx_soft_reset(&radar,XENSIV_BGT60TRXX_RESET_FIFO);
    if(!ret) ret=xensiv_bgt60trxx_enable_data_test_mode(&radar,false);
    if(!ret) ret=xensiv_bgt60trxx_start_frame(&radar,true);
    if(ret) return stream_error(ret);
    streaming=true;
    return 0;
}

int radar_stream_stop(void)
{
    if(!streaming) return 0;
    int ret=xensiv_bgt60trxx_start_frame(&radar,false);
    if(ret) return stream_error(ret);
    streaming=false;
    return 0;
}

int radar_stream_read(unsigned frames,uint16_t *samples,struct radar_result *out)
{
    memset(out,0,sizeof(*out));
    if(!ready || !streaming) return out->ret=-ENODEV;
    if(!frames || frames>RADAR_MAX_FRAMES || !samples) return out->ret=-EINVAL;
    int ret=0;
    uint32_t begin=k_cycle_get_32(); int64_t deadline=k_uptime_get()+2000;
    while(!ret && out->frames<frames) {
        ret=xensiv_bgt60trxx_get_reg(&radar,XENSIV_BGT60TRXX_REG_FSTAT_TR13C,&out->fstat);
        if(ret) break;
        if(out->fstat & (XENSIV_BGT60TRXX_REG_FSTAT_FOF_ERR_MSK |
                        XENSIV_BGT60TRXX_REG_FSTAT_FUF_ERR_MSK |
                        XENSIV_BGT60TRXX_REG_FSTAT_CLK_NUM_ERR_MSK |
                        XENSIV_BGT60TRXX_REG_FSTAT_SPI_BURST_ERR_MSK)) { ret=-EIO; break; }
        if(Cy_GPIO_Read(GPIO_PRT20,3)) out->irq_observed++;
        if((out->fstat & XENSIV_BGT60TRXX_REG_FSTAT_FILL_STATUS_MSK)>=RADAR_SAMPLES/2) {
            uint16_t *dst=samples+out->samples;
            ret=xensiv_bgt60trxx_get_fifo_data(&radar,dst,RADAR_SAMPLES);
            if(ret) break;
            out->frames++; out->samples+=RADAR_SAMPLES;
        } else k_msleep(1);
        if(k_uptime_get()>=deadline) { ret=-ETIMEDOUT; break; }
    }
    out->elapsed_us=k_cyc_to_us_floor32(k_cycle_get_32()-begin);
    if(ret) stream_error(ret);
    out->ret=ret; return ret;
}
```

## src/radar.h
```c
#pragma once
#include <stdbool.h>
#include <stdint.h>
#define RADAR_SAMPLES 128U
#define RADAR_MAX_FRAMES 64U
struct radar_result {
    uint32_t frames, samples, elapsed_us, mismatches, irq_observed, fstat;
    int ret;
};
int radar_init(void);
int radar_id(uint32_t *id);
/* Single owner: ai_worker, except radar_init while idle. The sensor FIFO
 * buffers frames during inference/output; never restart between windows. */
int radar_stream_start(void);
int radar_stream_read(unsigned frames, uint16_t *samples, struct radar_result *result);
int radar_stream_stop(void);
uint32_t radar_spi_hz(void);
```
