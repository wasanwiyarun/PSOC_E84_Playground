## CMakeLists.txt
```
cmake_minimum_required(VERSION 3.20.0)
find_package(Zephyr REQUIRED HINTS $ENV{ZEPHYR_BASE})
project(psoc_e84_lvgl_animated_waveform)

# Reuse the proven display pipeline from Chapter 017 and FT5406 driver from
# Chapter 018.  This chapter owns only the animated LVGL application.
set(DISPLAY_CHAPTER ${CMAKE_CURRENT_SOURCE_DIR}/../017_LVGL_Waveshare_4_3_Display)
set(TOUCH_CHAPTER ${CMAKE_CURRENT_SOURCE_DIR}/../018_LVGL_Waveshare_Touch_Input)
set(IFX_PDL ${ZEPHYR_HAL_INFINEON_MODULE_DIR}/mtb-dsl-pse8xxgp/pdl)
set(IFX_GFX ${IFX_PDL}/drivers/third_party/COMPONENT_GFXSS)

target_sources(app PRIVATE
  src/main.c
  src/fluid.c
  src/motion.c
  ${TOUCH_CHAPTER}/src/ft5406_touch.c
  ${DISPLAY_CHAPTER}/src/waveshare_4p3_display.c
  ${IFX_PDL}/drivers/source/cy_mipidsi.c
  ${IFX_GFX}/cy_graphics.c
  ${IFX_GFX}/vsi/dcnano8000/DCUser/rtos/viv_dc_interface.c
  ${IFX_GFX}/vsi/dcnano8000/DCUser/rtos/viv_dc_os.c
  ${IFX_GFX}/vsi/dcnano8000/DCUser/viv_dc_setting.c
  ${IFX_GFX}/vsi/dcnano8000/DCUser/viv_dc_tools.c
  ${IFX_GFX}/vsi/dcnano8000/DCUser/viv_dc_util.c
  ${IFX_GFX}/vsi/dcnano8000/DCKernel/rtos/viv_dc_platform.c
  ${IFX_GFX}/vsi/dcnano8000/DCKernel/hardware/8000Nano/viv_dc_hardware.c
  ${IFX_GFX}/vsi/dcnano8000/DCKernel/viv_dc_core.c
  ${IFX_GFX}/vsi/dcnano8000/DCKernel/viv_dc_database.c
  ${IFX_GFX}/vsi/dcnano8000/DCKernel/dc_layer_feature.c
  ${IFX_GFX}/vsi/dcnano8000/DCKernel/viv_dc_lcd.c
  ${IFX_GFX}/vsi/dcnano8000/DCKernel/viv_dc_shell.c)

zephyr_include_directories(
  ${TOUCH_CHAPTER}/src
  ${DISPLAY_CHAPTER}/src
  ${IFX_PDL}/devices/include
  ${IFX_PDL}/devices/include/ip
  ${IFX_PDL}/drivers/include
  ${IFX_GFX}
  ${IFX_GFX}/vsi/dcnano8000/include
  ${IFX_GFX}/vsi/dcnano8000/DCKernel
  ${IFX_GFX}/vsi/dcnano8000/DCKernel/hardware/8000Nano
  ${IFX_GFX}/vsi/dcnano8000/DCKernel/rtos
  ${IFX_GFX}/vsi/dcnano8000/DCUser
  ${IFX_GFX}/vsi/dcnano8000/DCUser/rtos)

target_compile_definitions(app PRIVATE
  PSE846GPS2DBZC4A COMPONENT_55500 COMPONENT_55500A1 COMPONENT_CM55
  COMPONENT_CM55_0 COMPONENT_GFXSS COMPONENT_NON_SECURE_DEVICE _BAREMETAL=0)
target_compile_options(app PRIVATE -include cy_pdl.h)
# Distances are positive and errno is never inspected. Allow hardware sqrt
# instead of a library call in the particle-neighbour hot loop.
set_source_files_properties(src/fluid.c PROPERTIES COMPILE_OPTIONS "-fno-math-errno")
```

## prj.conf
```kconfig
CONFIG_CONSOLE=y
CONFIG_UART_CONSOLE=y
CONFIG_PRINTK=y
CONFIG_I2C=y
CONFIG_SENSOR=y
CONFIG_BMI270=y
CONFIG_DISPLAY=y
CONFIG_LVGL=y
CONFIG_LV_Z_AUTO_INIT=n
CONFIG_LV_Z_MEM_POOL_SIZE=65536
CONFIG_ASSERT=y
CONFIG_LV_COLOR_DEPTH_16=y
CONFIG_LV_Z_BUFFER_ALLOC_STATIC=y
CONFIG_LV_Z_VDB_ZEPHYR_REGION=y
CONFIG_LV_Z_VDB_ZEPHYR_REGION_NAME="GFX_MEM"
CONFIG_LV_Z_VDB_SIZE=100
CONFIG_LV_Z_FULL_REFRESH=y
CONFIG_LV_Z_VDB_ALIGN=128
CONFIG_LV_Z_DOUBLE_VDB=y
CONFIG_HEAP_MEM_POOL_SIZE=16384
CONFIG_MAIN_STACK_SIZE=8192
CONFIG_CRC=y
CONFIG_LV_FONT_MONTSERRAT_20=y
CONFIG_LV_FONT_MONTSERRAT_28=y
CONFIG_LV_USE_IMAGE=y
CONFIG_SPEED_OPTIMIZATIONS=y
```

## dts/bindings/display/waveshare,ws43.yaml
```yaml
description: Waveshare 4.3-inch Raspberry Pi DSI display on PSoC Edge E84 GFXSS

compatible: "waveshare,ws43"

include: [i2c-device.yaml, display-controller.yaml]
```

## src/main.c
```c
#include <zephyr/drivers/display.h>
#include <zephyr/drivers/sensor.h>
#include <zephyr/drivers/uart.h>
#include <zephyr/init.h>
#include <zephyr/kernel.h>
#include <zephyr/sys/crc.h>
#include <cy_sysclk.h>
#include <lvgl.h>
#include <lvgl_zephyr.h>
#include <math.h>
#include <stdio.h>
#include <string.h>
#include "ft5406_touch.h"
#include "fluid.h"
#include "motion.h"

#define INTERVAL_MS 33
static const struct device *display = DEVICE_DT_GET(DT_CHOSEN(zephyr_display));
static const struct device *imu = DEVICE_DT_GET(DT_ALIAS(accel0));
static lv_obj_t *mode_label, *water_image;
static uint16_t pixels[FLUID_WIDTH * FLUID_HEIGHT] __aligned(8);
/* Pre-expand the small fluid raster: LVGL's per-pixel software image scaling
 * costs more than the entire physics solver on this board. */
static uint16_t screen_pixels[FLUID_WIDTH * 4 * FLUID_HEIGHT * 4]
	__attribute__((section("GFX_MEM"), aligned(128)));
static const lv_image_dsc_t water_bitmap = {
	.header = { .magic = LV_IMAGE_HEADER_MAGIC, .cf = LV_COLOR_FORMAT_RGB565,
		.w = FLUID_WIDTH * 4, .h = FLUID_HEIGHT * 4, .stride = FLUID_WIDTH * 8 },
	.data_size = sizeof(screen_pixels), .data = (const uint8_t *)screen_pixels,
};
static uint32_t updates, motion_reads, step_us, frame_ms, pixel_crc;
static float gravity_x, gravity_y = 120;
static int32_t ax_mg, ay_mg, az_mg;
static int last_imu_error;
static bool imu_ready;
/* Test gravity is visibly labelled and automatically expires. */
static const char *mode = "imu";
static int64_t override_until;

static int display_clock_metadata_init(void)
{
	Cy_SysClk_EcoSetFrequency(17203200U);
	return 0;
}
SYS_INIT(display_clock_metadata_init, PRE_KERNEL_1, 0);

static int32_t acceleration_mg(const struct sensor_value *v)
{ return (int32_t)(((int64_t)v->val1 * 1000000 + v->val2) / 9807); }

static int sample_motion(void)
{
	struct sensor_value accel[3];
	int ret = sensor_sample_fetch(imu);
	if (ret == 0) ret = sensor_channel_get(imu, SENSOR_CHAN_ACCEL_XYZ, accel);
	last_imu_error = ret;
	if (ret != 0) return ret;
	ax_mg = acceleration_mg(&accel[0]);
	ay_mg = acceleration_mg(&accel[1]);
	az_mg = acceleration_mg(&accel[2]);
	float gx, gy;
	motion_screen_gravity(ax_mg, ay_mg, &gx, &gy);
	gravity_x += (gx - gravity_x) * 0.65f;
	gravity_y += (gy - gravity_y) * 0.65f;
	motion_reads++;
	return 0;
}

static void reset_water(lv_event_t *event)
{
	ARG_UNUSED(event);
	fluid_reset(); mode = "imu"; override_until = 0;
	printk("OK WATER RESET particles=%u\n", FLUID_PARTICLES);
}

static void report_status(const char *token)
{
	struct ft5406_status touch;
	ft5406_get_status(&touch);
	printk("OK WATER STATUS token=%s imu_ready=%u motion_reads=%u tilt=%d updates=%u "
	       "mode=%s particles=%u valid=%d center=%d,%d pixels=%u crc=%08x "
	       "accel=%d,%d,%d gravity=%d,%d step_us=%u frame_ms=%u "
	       "touch_ready=%u polls=%u reads=%u touches=%u ret=%d\n",
	       token, imu_ready, motion_reads, (int)(gravity_x / 2), updates, mode,
	       FLUID_PARTICLES, fluid_valid(), fluid_center_x(), fluid_center_y(),
	       fluid_pixels(), pixel_crc, ax_mg, ay_mg, az_mg, (int)gravity_x,
	       (int)gravity_y, step_us, frame_ms, touch.ready, touch.polls,
	       touch.reads, touch.touches, last_imu_error ? last_imu_error : touch.last_error);
}

static void handle_command(char *line)
{
	char command[16], token[40], extra;
	if (sscanf(line, "water %15s %39s %c", command, token, &extra) != 2) {
		printk("FAIL WATER COMMAND expected='water COMMAND TOKEN'\n"); return;
	}
	if (!strcmp(command, "reset") || !strcmp(command, "level")) reset_water(NULL);
	else if (!strcmp(command, "auto")) { mode = "imu"; override_until = 0; }
	else if (!strcmp(command, "left")) mode = "left";
	else if (!strcmp(command, "right")) mode = "right";
	else if (!strcmp(command, "up")) mode = "up";
	else if (!strcmp(command, "down")) mode = "down";
	else if (strcmp(command, "info")) {
		printk("FAIL WATER COMMAND token=%s\n", token); return;
	}
	if (strcmp(command, "info") && strcmp(mode, "imu"))
		override_until = k_uptime_get() + 15000;
	report_status(token);
}

static void render_water(void)
{
	uint32_t begin = k_cycle_get_32();
	float gx = gravity_x, gy = gravity_y;
	if (override_until && k_uptime_get() >= override_until) { mode = "imu"; override_until = 0; }
	if (!strcmp(mode, "left")) { gx = -160; gy = 30; }
	if (!strcmp(mode, "right")) { gx = 160; gy = 30; }
	if (!strcmp(mode, "up")) { gx = 0; gy = -160; }
	if (!strcmp(mode, "down")) { gx = 0; gy = 160; }
	fluid_advance(gx, gy, frame_ms ? frame_ms : INTERVAL_MS);
	fluid_render(pixels);
	for (int y = 0; y < FLUID_HEIGHT; ++y) {
		uint16_t *row = &screen_pixels[y * 4 * FLUID_WIDTH * 4];
		for (int x = 0; x < FLUID_WIDTH; ++x) {
			uint16_t color = pixels[y * FLUID_WIDTH + x];
			row[x * 4] = color; row[x * 4 + 1] = color;
			row[x * 4 + 2] = color; row[x * 4 + 3] = color;
		}
		for (int repeat = 1; repeat < 4; ++repeat)
			memcpy(row + repeat * FLUID_WIDTH * 4, row, FLUID_WIDTH * 8);
	}
	pixel_crc = crc32_ieee((const uint8_t *)pixels, sizeof(pixels));
	step_us = k_cyc_to_us_floor32(k_cycle_get_32() - begin);
	lv_obj_invalidate(water_image);
	if (updates % 6 == 0) {
		if (!strcmp(mode, "imu")) lv_label_set_text(mode_label, "TILT TO POUR  /  SHAKE TO SPLASH");
		else lv_label_set_text_fmt(mode_label, "TEST GRAVITY: %s", mode);
	}
	updates++;
}

static int create_ui(void)
{
	lv_obj_t *screen = lv_screen_active();
	lv_obj_set_style_bg_color(screen, lv_color_hex(0x02070D), 0);
	lv_obj_remove_flag(screen, LV_OBJ_FLAG_SCROLLABLE);
	lv_obj_t *title = lv_label_create(screen);
	lv_label_set_text(title, "TESA AIoT E84  /  FLUID SIMULATION");
	lv_obj_set_style_text_color(title, lv_color_hex(0xBDEBFF), 0);
	lv_obj_set_style_text_font(title, &lv_font_montserrat_20, 0);
	lv_obj_align(title, LV_ALIGN_TOP_LEFT, 36, 18);
	mode_label = lv_label_create(screen);
	lv_obj_set_style_text_color(mode_label, lv_color_hex(0x28D8FF), 0);
	lv_obj_align(mode_label, LV_ALIGN_TOP_LEFT, 36, 48);
	lv_obj_t *tank = lv_obj_create(screen);
	lv_obj_set_size(tank, FLUID_WIDTH * 4 + 6, FLUID_HEIGHT * 4 + 6);
	lv_obj_align(tank, LV_ALIGN_TOP_MID, 0, 78);
	lv_obj_set_style_bg_color(tank, lv_color_hex(0x000408), 0);
	lv_obj_set_style_border_color(tank, lv_color_hex(0x65D8FF), 0);
	lv_obj_set_style_border_width(tank, 3, 0);
	lv_obj_set_style_radius(tank, 0, 0);
	lv_obj_set_style_pad_all(tank, 0, 0);
	lv_obj_remove_flag(tank, LV_OBJ_FLAG_SCROLLABLE);
	water_image = lv_image_create(tank);
	if (!water_image) return -ENOMEM;
	lv_image_set_src(water_image, &water_bitmap);
	lv_obj_set_pos(water_image, 0, 0);
	fluid_reset(); render_water();
	lv_obj_t *button = lv_button_create(screen);
	lv_obj_set_size(button, 260, 48);
	lv_obj_align(button, LV_ALIGN_BOTTOM_MID, 0, -14);
	lv_obj_set_style_bg_color(button, lv_color_hex(0x075F89), 0);
	lv_obj_add_event_cb(button, reset_water, LV_EVENT_CLICKED, NULL);
	lv_obj_t *label = lv_label_create(button);
	lv_label_set_text(label, "RESET WATER");
	lv_obj_set_style_text_font(label, &lv_font_montserrat_20, 0);
	lv_obj_center(label);
	return 0;
}

int main(void)
{
	const struct device *uart = DEVICE_DT_GET(DT_CHOSEN(zephyr_console));
	if (!device_is_ready(display)) { printk("FAIL WATER DISPLAY_NOT_READY\n"); return 0; }
	int ret = lvgl_init();
	if (ret || !lv_display_get_default()) { printk("FAIL WATER LVGL_INIT ret=%d\n", ret); return 0; }
	if (ft5406_init()) { printk("FAIL WATER FT5406_INIT\n"); return 0; }
	ft5406_lvgl_register();
	const struct sensor_value hz = { .val1 = 100, .val2 = 0 };
	last_imu_error = device_is_ready(imu) ? sensor_attr_set(imu,
		SENSOR_CHAN_ACCEL_XYZ, SENSOR_ATTR_SAMPLING_FREQUENCY, &hz) : -ENODEV;
	k_msleep(100);
	if (!last_imu_error) sample_motion();
	imu_ready = last_imu_error == 0;
	if (!imu_ready) { printk("FAIL WATER BMI270_INIT ret=%d\n", last_imu_error); return 0; }
	if (create_ui()) { printk("FAIL WATER UI_CREATE\n"); return 0; }
	lv_refr_now(NULL);
	ret = display_blanking_off(display);
	if (ret) { printk("FAIL WATER BACKLIGHT ret=%d\n", ret); return 0; }
	printk("OK WATER INITIALIZATION_SUCCESS engine=particles bmi270=1 particles=%u interval_ms=%u\n",
		FLUID_PARTICLES, INTERVAL_MS);
	printk("INFO WATER COMMANDS water info|reset|auto|left|right|up|down TOKEN\n");
	int64_t next_update = k_uptime_get(), last_frame = next_update;
	char line[96]; size_t used = 0; bool overflow = false;
	while (true) {
		ft5406_poll();
		int64_t now = k_uptime_get();
		if (now >= next_update) {
			frame_ms = (uint32_t)(now - last_frame); last_frame = now;
			sample_motion(); render_water();
			/* Avoid accumulating catch-up work after slow display refresh. */
			next_update = now + INTERVAL_MS;
		}
		unsigned char ch;
		while (uart_poll_in(uart, &ch) == 0) {
			if (ch == '\r' || ch == '\n') {
				if (overflow) printk("FAIL WATER COMMAND too_long\n");
				else if (used) { line[used] = '\0'; handle_command(line); }
				used = 0; overflow = false;
			} else if (used < sizeof(line) - 1) line[used++] = ch;
			else overflow = true;
		}
		lv_timer_handler(); k_msleep(2);
	}
}
```

## src/fluid.c
```c
#include "fluid.h"
#include <math.h>
#include <string.h>

/* Small 2-D double-density relaxation solver. Units are bitmap pixels and
 * seconds. The same engine is compiled into the firmware and host tests. */
#define RADIUS 7.0f
#define CELL 7
#define NX ((FLUID_WIDTH + CELL - 1) / CELL)
#define NY ((FLUID_HEIGHT + CELL - 1) / CELL)
#define DT (1.0f / 60.0f)
struct particle { float x, y, ox, oy, vx, vy; };
static struct particle p[FLUID_PARTICLES];
static int16_t heads[NX * NY], next[FLUID_PARTICLES];
static uint16_t density_map[FLUID_WIDTH * FLUID_HEIGHT];
static unsigned wet_pixels;
/* Accumulate milliseconds * 60 to avoid rounding drift at 60 physics Hz. */
static uint32_t time_units;

static float clampf(float x, float lo, float hi)
{ return x < lo ? lo : (x > hi ? hi : x); }

void fluid_reset(void)
{
	time_units = 0;
	for (int i = 0; i < FLUID_PARTICLES; ++i) {
		p[i] = (struct particle){ .x = 22.0f + (i % 48) * 2.8f,
			.y = 40.0f + (i / 48) * 2.8f };
	}
}

static void grid_build(void)
{
	memset(heads, -1, sizeof(heads));
	for (int i = 0; i < FLUID_PARTICLES; ++i) {
		int x = (int)clampf(p[i].x / CELL, 0, NX - 1);
		int y = (int)clampf(p[i].y / CELL, 0, NY - 1);
		int cell = y * NX + x;
		next[i] = heads[cell]; heads[cell] = i;
	}
}

static void substep(float gx, float gy)
{
	for (int i = 0; i < FLUID_PARTICLES; ++i) {
		p[i].ox = p[i].x; p[i].oy = p[i].y;
		p[i].vx = clampf((p[i].vx + gx * DT) * 0.998f, -220, 220);
		p[i].vy = clampf((p[i].vy + gy * DT) * 0.998f, -220, 220);
		p[i].x = clampf(p[i].x + p[i].vx * DT, 2, FLUID_WIDTH - 3);
		p[i].y = clampf(p[i].y + p[i].vy * DT, 2, FLUID_HEIGHT - 3);
	}
	grid_build();
	for (int i = 0; i < FLUID_PARTICLES; ++i) {
		/* Freeze neighbour coordinates during this particle's density solve. */
		int neighbours[96], count = 0;
		float qs[96], dxs[96], dys[96];
		float rho = 0, near_rho = 0;
		int cx = (int)(p[i].x / CELL), cy = (int)(p[i].y / CELL);
		for (int yy = cy - 1; yy <= cy + 1; ++yy) {
			if (yy < 0 || yy >= NY) continue;
			for (int xx = cx - 1; xx <= cx + 1; ++xx) {
				if (xx < 0 || xx >= NX) continue;
				for (int j = heads[yy * NX + xx]; j >= 0; j = next[j]) {
					if (j == i) continue;
					float dx = p[j].x - p[i].x, dy = p[j].y - p[i].y;
					float r2 = dx * dx + dy * dy;
					if (r2 >= RADIUS * RADIUS || r2 < 0.00001f) continue;
					float r = sqrtf(r2), q = 1.0f - r / RADIUS;
					rho += q * q; near_rho += q * q * q;
					if (count < 96) {
						neighbours[count] = j; qs[count] = q;
						dxs[count] = dx / r; dys[count++] = dy / r;
					}
				}
			}
		}
		float pressure = clampf(350.0f * (rho - 4.0f), -120, 2500);
		float near_pressure = 800.0f * near_rho;
		float move_x = 0, move_y = 0;
		for (int n = 0; n < count; ++n) {
			float q = qs[n];
			float d = clampf(DT * DT * (pressure * q + near_pressure * q * q) * 0.5f,
				-0.08f, 0.5f);
			float dx = d * dxs[n], dy = d * dys[n];
			p[neighbours[n]].x += dx; p[neighbours[n]].y += dy;
			move_x -= dx; move_y -= dy;
		}
		p[i].x += move_x; p[i].y += move_y;
	}
	for (int i = 0; i < FLUID_PARTICLES; ++i) {
		p[i].x = clampf(p[i].x, 2, FLUID_WIDTH - 3);
		p[i].y = clampf(p[i].y, 2, FLUID_HEIGHT - 3);
		p[i].vx = (p[i].x - p[i].ox) / DT;
		p[i].vy = (p[i].y - p[i].oy) / DT;
	}
}

void fluid_step(float gx, float gy)
{
	gx = clampf(gx, -280, 280); gy = clampf(gy, -280, 280);
	substep(gx, gy); substep(gx, gy);
}

unsigned fluid_advance(float gx, float gy, uint32_t elapsed_ms)
{
	/* Keep the stable 1/60 s timestep, but run enough substeps for the time
	 * spent refreshing the display. Bound catch-up after pauses to six steps. */
	if (elapsed_ms > 100) elapsed_ms = 100;
	time_units += elapsed_ms * 60;
	unsigned steps = time_units / 1000;
	time_units %= 1000;
	gx = clampf(gx, -280, 280); gy = clampf(gy, -280, 280);
	for (unsigned i = 0; i < steps; ++i) substep(gx, gy);
	return steps;
}

/* Rasterize a smooth density field so neighbouring particles form one liquid
 * body, while detached particles remain visible as droplets. No LVGL objects
 * per particle and no pre-drawn waterline. */
void fluid_render(uint16_t *pixels)
{
	memset(density_map, 0, sizeof(density_map));
	for (int i = 0; i < FLUID_PARTICLES; ++i) {
		int cx = (int)p[i].x, cy = (int)p[i].y;
		for (int y = cy - 4; y <= cy + 4; ++y) {
			if (y < 0 || y >= FLUID_HEIGHT) continue;
			for (int x = cx - 4; x <= cx + 4; ++x) {
				if (x < 0 || x >= FLUID_WIDTH) continue;
				float dx = x - p[i].x, dy = y - p[i].y;
				float w = 1.0f - (dx * dx + dy * dy) / 16.0f;
				if (w > 0) density_map[y * FLUID_WIDTH + x] += (uint16_t)(w * w * 100);
			}
		}
	}
	wet_pixels = 0;
	for (int y = 0; y < FLUID_HEIGHT; ++y) {
		for (int x = 0; x < FLUID_WIDTH; ++x) {
			int k = y * FLUID_WIDTH + x;
			uint16_t d = density_map[k];
			pixels[k] = 0x0021; /* almost black */
			if (d < 45) continue;
			wet_pixels++;
			/* Thin pale foam edge, cyan shallow water, deep blue interior. */
			if (d < 90 || (y > 0 && density_map[k - FLUID_WIDTH] < 45))
				pixels[k] = 0xbfff;
			else pixels[k] = (uint16_t)(((24 + (FLUID_HEIGHT - y) / 3) << 5) | 29);
		}
	}
}

int fluid_valid(void)
{
	for (int i = 0; i < FLUID_PARTICLES; ++i)
		if (!isfinite(p[i].x) || !isfinite(p[i].y) || !isfinite(p[i].vx) ||
		    !isfinite(p[i].vy) || p[i].x < 2 || p[i].x > FLUID_WIDTH - 3 ||
		    p[i].y < 2 || p[i].y > FLUID_HEIGHT - 3) return 0;
	return 1;
}
int fluid_center_x(void)
{ float v = 0; for (int i = 0; i < FLUID_PARTICLES; ++i) v += p[i].x; return (int)(v / FLUID_PARTICLES); }
int fluid_center_y(void)
{ float v = 0; for (int i = 0; i < FLUID_PARTICLES; ++i) v += p[i].y; return (int)(v / FLUID_PARTICLES); }
unsigned fluid_pixels(void) { return wet_pixels; }
```

## src/fluid.h
```c
#ifndef WATER_FLUID_H
#define WATER_FLUID_H
#include <stdint.h>
#define FLUID_WIDTH 180
#define FLUID_HEIGHT 78
#define FLUID_PARTICLES 480
void fluid_reset(void);
void fluid_step(float gx, float gy);
unsigned fluid_advance(float gx, float gy, uint32_t elapsed_ms);
void fluid_render(uint16_t *pixels);
int fluid_valid(void);
int fluid_center_x(void);
int fluid_center_y(void);
unsigned fluid_pixels(void);
#endif
```

## src/motion.c
```c
#include "motion.h"
#include <math.h>

void motion_screen_gravity(int32_t ax_mg, int32_t ay_mg, float *gx, float *gy)
{
	/* TESA landscape mounting: screen right is +sensor X acceleration;
	 * screen down is -sensor Y acceleration. Both signs in the initial
	 * demo were reversed, so liquid collected against the lifted edge.
	 * Z points out of the screen and must not overpower in-plane gravity. */
	*gx = (float)ax_mg * 0.27f;
	*gy = -(float)ay_mg * 0.27f;

	/* A weak downward preference only while almost flat (< about 5 deg).
	 * Fade it out entirely before an appreciable tilt; never use |Z| as a
	 * permanent downward force, which prevents pouring toward the top. */
	float planar_mg = sqrtf((float)ax_mg * ax_mg + (float)ay_mg * ay_mg);
	if (planar_mg < 80.0f)
		*gy += 24.0f * (1.0f - planar_mg / 80.0f);
}
```

## src/motion.h
```c
#ifndef WATER_MOTION_H
#define WATER_MOTION_H
#include <stdint.h>
void motion_screen_gravity(int32_t ax_mg, int32_t ay_mg, float *gx, float *gy);
#endif
```
