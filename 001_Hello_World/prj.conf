## CMakeLists.txt
```
# SPDX-License-Identifier: Apache-2.0

cmake_minimum_required(VERSION 3.20.0)

find_package(Zephyr REQUIRED HINTS $ENV{ZEPHYR_BASE})
project(psoc_e84_hello_world)

target_sources(app PRIVATE src/main.c)
```

## prj.conf
```kconfig
# Enable the console backend used by printk().
CONFIG_CONSOLE=y

# Keep the sample's stack allocation explicit and modest.
CONFIG_MAIN_STACK_SIZE=1024
```

## src/main.c
```c
/*
 * SPDX-License-Identifier: Apache-2.0
 */

#include <zephyr/kernel.h>
#include <zephyr/sys/printk.h>

int main(void)
{
	/* Let a host serial monitor attach after reset before printing the result. */
	k_sleep(K_SECONDS(2));

	printk("Hello from the PSOC Edge84 Zephyr playground!\n");

	return 0;
}
```
