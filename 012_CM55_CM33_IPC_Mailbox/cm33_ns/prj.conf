## CMakeLists.txt
```
cmake_minimum_required(VERSION 3.20.0)
find_package(Zephyr REQUIRED HINTS $ENV{ZEPHYR_BASE})
project(psoc_e84_cm33_ns_relay_host)

target_sources(app PRIVATE src/main.c)
```

## prj.conf
```kconfig
CONFIG_CONSOLE=y
CONFIG_SERIAL=y
CONFIG_UART_CONSOLE=y
CONFIG_MAIN_STACK_SIZE=2048
CONFIG_PSOC_EDGE_M55_SRF_SUPPORT=y
```

## src/main.c
```c
#include <stdint.h>

#include <psa/client.h>
#include <zephyr/kernel.h>
#include <zephyr/sys/printk.h>

int main(void)
{
	uint32_t version = psa_framework_version();

	printk("OK CORE=CM33-NS ROLE=RELAY_HOST PSA_VERSION=0x%08x\n", version);
	printk("INFO CM33-NS boots CM55; CM55 PSA calls are relayed here by TF-M\n");

	for (;;) {
		k_sleep(K_SECONDS(1));
	}
}
```
