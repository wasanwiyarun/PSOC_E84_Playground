## CMakeLists.txt
```
cmake_minimum_required(VERSION 3.20.0)
list(APPEND DTS_ROOT ${CMAKE_CURRENT_SOURCE_DIR}/../../018_LVGL_Waveshare_Touch_Input)
find_package(Zephyr REQUIRED HINTS $ENV{ZEPHYR_BASE})
project(encrypted_sensor_logger)
include(../../common/encrypted_files/qspi_geometry.cmake)
set(DISPLAY_CHAPTER ${CMAKE_CURRENT_SOURCE_DIR}/../../017_LVGL_Waveshare_4_3_Display)
set(TOUCH_CHAPTER ${CMAKE_CURRENT_SOURCE_DIR}/../../018_LVGL_Waveshare_Touch_Input)
set(IFX_PDL ${ZEPHYR_HAL_INFINEON_MODULE_DIR}/mtb-dsl-pse8xxgp/pdl)
set(IFX_GFX ${IFX_PDL}/drivers/third_party/COMPONENT_GFXSS)
set(DC ${IFX_GFX}/vsi/dcnano8000)
target_sources(app PRIVATE
  src/logger.c src/store.c src/flash_guard.c
  src/display_clock.c
  ${CMAKE_CURRENT_SOURCE_DIR}/../../020_Kalman_Artificial_Horizon/src/sensor_bus_recovery.c
  ${TOUCH_CHAPTER}/src/ft5406_touch.c
  ${DISPLAY_CHAPTER}/src/waveshare_4p3_display.c
  ${IFX_PDL}/drivers/source/cy_mipidsi.c
  ${IFX_GFX}/cy_graphics.c
  ${DC}/DCUser/rtos/viv_dc_interface.c ${DC}/DCUser/rtos/viv_dc_os.c
  ${DC}/DCUser/viv_dc_setting.c ${DC}/DCUser/viv_dc_tools.c ${DC}/DCUser/viv_dc_util.c
  ${DC}/DCKernel/rtos/viv_dc_platform.c ${DC}/DCKernel/hardware/8000Nano/viv_dc_hardware.c
  ${DC}/DCKernel/viv_dc_core.c ${DC}/DCKernel/viv_dc_database.c
  ${DC}/DCKernel/dc_layer_feature.c ${DC}/DCKernel/viv_dc_lcd.c ${DC}/DCKernel/viv_dc_shell.c
  ${ZEPHYR_TRUSTED_FIRMWARE_M_MODULE_DIR}/interface/src/tfm_crypto_api.c
  ${ZEPHYR_TRUSTED_FIRMWARE_M_MODULE_DIR}/interface/src/tfm_ps_api.c
  ${ZEPHYR_TRUSTED_FIRMWARE_M_MODULE_DIR}/interface/src/tfm_platform_api.c)
zephyr_include_directories(
  ${TOUCH_CHAPTER}/src ${DISPLAY_CHAPTER}/src
  ${IFX_PDL}/devices/include ${IFX_PDL}/devices/include/ip ${IFX_PDL}/drivers/include
  ${IFX_GFX} ${DC}/include ${DC}/DCKernel ${DC}/DCKernel/hardware/8000Nano
  ${DC}/DCKernel/rtos ${DC}/DCUser ${DC}/DCUser/rtos
  ${PSE84_CM33_BUILD_DIR}/tfm/api_ns/interface/include)
target_compile_definitions(app PRIVATE
  TFM_PSA_CRYPTO_CLIENT_ONLY
  TF_PSA_CRYPTO_CONFIG_FILE="${PSE84_CM33_BUILD_DIR}/tfm/api_ns/interface/include/mbedtls/tf_psa_crypto_config.h"
  PSE846GPS2DBZC4A COMPONENT_55500 COMPONENT_55500A1 COMPONENT_CM55
  COMPONENT_CM55_0 COMPONENT_GFXSS COMPONENT_NON_SECURE_DEVICE _BAREMETAL=0)
target_compile_options(app PRIVATE -include cy_pdl.h)
zephyr_link_libraries(-Wl,--wrap=Cy_SysPm_MiscLdoConfigure)
zephyr_link_libraries(-Wl,--wrap=mtb_serial_memory_write -Wl,--wrap=mtb_serial_memory_erase)
```

## prj.conf
```kconfig
CONFIG_CONSOLE=y
CONFIG_UART_CONSOLE=y
CONFIG_PRINTK=y
CONFIG_LOG=y
CONFIG_LOG_MODE_IMMEDIATE=y
CONFIG_LOG_DEFAULT_LEVEL=1
CONFIG_PSOC_EDGE_M55_SRF_SUPPORT=y
CONFIG_I2C=y
CONFIG_SENSOR=y
CONFIG_BMI270=y
CONFIG_DPS310=y
CONFIG_DISPLAY=y
CONFIG_LVGL=y
CONFIG_LV_Z_AUTO_INIT=n
CONFIG_LV_Z_MEM_POOL_SIZE=65536
CONFIG_ASSERT=y
CONFIG_LV_COLOR_DEPTH_16=y
CONFIG_LV_Z_BUFFER_ALLOC_STATIC=y
CONFIG_LV_Z_VDB_ZEPHYR_REGION=y
CONFIG_LV_Z_VDB_ZEPHYR_REGION_NAME="GFX_MEM"
CONFIG_LV_Z_VDB_SIZE=100
CONFIG_LV_Z_FULL_REFRESH=y
CONFIG_LV_Z_VDB_ALIGN=128
CONFIG_LV_Z_DOUBLE_VDB=y
CONFIG_LV_FONT_MONTSERRAT_20=y
CONFIG_LV_FONT_MONTSERRAT_28=y
CONFIG_HEAP_MEM_POOL_SIZE=16384
CONFIG_MAIN_STACK_SIZE=8192
CONFIG_CRC=y
CONFIG_FLASH=y
CONFIG_FLASH_MAP=y
CONFIG_FILE_SYSTEM=y
CONFIG_FILE_SYSTEM_LITTLEFS=y
CONFIG_FILE_SYSTEM_MKFS=y
CONFIG_REBOOT=y
```

## app.overlay
```dts
#include "../../020_Kalman_Artificial_Horizon/app.overlay"

/* M55's chosen flash is the SAHB alias of the same S25HS512T. The board's
 * alias incorrectly advertises 64 KiB sectors; flash0 correctly uses 256 KiB. */
&flash0_sahb { erase-block-size = <0x40000>; };

/* Dedicated area; initialization refuses any non-erased, unmountable media. */
&flash0 {
    partitions {
        logger_partition: partition@1780000 {
            compatible = "zephyr,mapped-partition";
            label = "encrypted-logger";
            reg = <0x1780000 0x300000>;
        };
    };
};
```

## src/display_clock.c
```c
/* TF-M keeps SRSS_MAIN secure. Supply setup belongs to the secure BSP. */
#include <cy_pdl.h>

/* The secure BSP has already configured and checked the MIPI supply. The
 * library's direct non-secure MISCLDO write is forbidden by TF-M. Only accept
 * the identical, immutable configuration used by this paired secure image. */
cy_en_syspm_status_t __wrap_Cy_SysPm_MiscLdoConfigure(cy_stc_syspm_miscldo_params_t *p)
{
    if(!p || !p->miscLdoEnable || p->miscLdoMode!=CY_SYSPM_MISCLDO_VCCACT ||
       p->miscLdoVoltSel!=CY_SYSPM_MISCLDO_VOLTAGE_0_90V ||
       p->miscLdoVaccActTrimSel!=CY_SYSPM_MISCLDO_VCCACT_TRIM_0)
        return CY_SYSPM_BAD_PARAM;
    return CY_SYSPM_SUCCESS;
}
```

## src/flash_guard.c
```c
/* Serialize each flash mutation with a secure, RAM-resident CM33 pause.
 * The helper blocks in PSA while the storage thread performs the actual write.
 * Callers must not start another PSA/SRF operation until this guard completes.
 */
#include <errno.h>
#include <zephyr/kernel.h>
#include <zephyr/cache.h>
#include <zephyr/sys/printk.h>
#include <tfm_platform_api.h>
#include <mtb_serial_memory.h>

BUILD_ASSERT(IS_ENABLED(CONFIG_CACHE_MANAGEMENT), "Flash handshake needs cache maintenance");
BUILD_ASSERT(CONFIG_DCACHE_LINE_SIZE <= 64, "Handshake words must occupy separate cache lines");

static struct {
    volatile uint32_t request;
    uint8_t pad0[60];
    volatile uint32_t ack;
    uint8_t pad1[60];
} handshake __aligned(64);
K_SEM_DEFINE(park_request, 0, 1);
K_SEM_DEFINE(park_done, 0, 1);
K_MUTEX_DEFINE(guard_lock);
static enum tfm_platform_err_t park_result;

static void park_worker(void *a, void *b, void *c)
{
    ARG_UNUSED(a); ARG_UNUSED(b); ARG_UNUSED(c);
    for (;;) {
        k_sem_take(&park_request, K_FOREVER);
        uint32_t address = (uint32_t)&handshake;
        psa_invec in = { &address, sizeof(address) };
        park_result = tfm_platform_ioctl(0x40000000, &in, NULL);
        k_sem_give(&park_done);
    }
}
K_THREAD_DEFINE(park_thread, 2048, park_worker, NULL, NULL, NULL, 2, 0, 0);

static int guard_begin(void)
{
    k_mutex_lock(&guard_lock, K_FOREVER);
    handshake.request = 1;
    sys_cache_data_flush_range((void *)&handshake.request, 64);
    k_sem_give(&park_request);
    int64_t deadline = k_uptime_get() + 5000;
    do {
        sys_cache_data_invd_range((void *)&handshake.ack, 64);
        if (handshake.ack == 1) return 0;
        k_sleep(K_MSEC(1));
    } while (k_uptime_get() < deadline);
    handshake.request = 0;
    sys_cache_data_flush_range((void *)&handshake.request, 64);
    /* Do not resume flash access if the secure call has not returned. */
    k_sem_take(&park_done, K_FOREVER);
    printk("ERR FLASH_PAUSE rc=%d\n", park_result);
    k_mutex_unlock(&guard_lock);
    return -EIO;
}
static void guard_end(void)
{
    handshake.request = 0;
    sys_cache_data_flush_range((void *)&handshake.request, 64);
    k_sem_take(&park_done, K_FOREVER);
    k_mutex_unlock(&guard_lock);
}

extern cy_rslt_t __real_mtb_serial_memory_write(mtb_serial_memory_t *, uint32_t,
                                               size_t, const uint8_t *);
extern cy_rslt_t __real_mtb_serial_memory_erase(mtb_serial_memory_t *, uint32_t, size_t);
cy_rslt_t __wrap_mtb_serial_memory_write(mtb_serial_memory_t *obj, uint32_t addr,
                                        size_t size, const uint8_t *data)
{
    if (guard_begin()) return (cy_rslt_t)-EIO;
    cy_rslt_t ret = __real_mtb_serial_memory_write(obj, addr, size, data);
    guard_end();
    return ret;
}
cy_rslt_t __wrap_mtb_serial_memory_erase(mtb_serial_memory_t *obj, uint32_t addr, size_t size)
{
    if (guard_begin()) return (cy_rslt_t)-EIO;
    cy_rslt_t ret = __real_mtb_serial_memory_erase(obj, addr, size);
    guard_end();
    return ret;
}
```

## src/logger.c
```c
/* UI, acquisition and storage are separate threads. Only the storage worker
 * owns LittleFS and cryptographic state. No plaintext ever goes to flash. */
#include <errno.h>
#include <stdlib.h>
#include <string.h>
#include <zephyr/kernel.h>
#include <zephyr/init.h>
#include <zephyr/drivers/display.h>
#include <zephyr/drivers/sensor.h>
#include <zephyr/drivers/uart.h>
#include <zephyr/sys/byteorder.h>
#include <zephyr/sys/reboot.h>
#include <lvgl.h>
#include <lvgl_zephyr.h>
#include "store.h"
#include "ft5406_touch.h"
#include "waveshare_4p3_display.h"

static const struct device *const display=DEVICE_DT_GET(DT_CHOSEN(zephyr_display));
static const struct device *const imu=DEVICE_DT_GET(DT_ALIAS(accel0));
static const struct device *const baro=DEVICE_DT_GET(DT_ALIAS(pressure_sensor));
static K_MUTEX_DEFINE(lock);
/* Flash/secure-service calls can stall XIP interrupt service. Do not start
 * them in the middle of a sensor transaction on SCB0. */
static K_MUTEX_DEFINE(acquisition_gate);
K_MSGQ_DEFINE(samples,SAMPLE_BYTES,128,4);
K_MSGQ_DEFINE(commands,96,4,4);
static K_THREAD_STACK_DEFINE(sensor_stack,3072);
static K_THREAD_STACK_DEFINE(storage_stack,8192);
static struct k_thread sensor_thread,storage_thread;
struct status {
    struct store_status disk;
    uint64_t time_ms;
    int32_t values[8];
    uint32_t acquired,errors,dropped,ui_frames;
    bool valid,recording,display_ok,touch_ok;
    int error;
};
static struct status state;
static lv_obj_t *mode_label,*count_label,*acc_label,*gyro_label,*env_label,*space_label,*note_label;
static uint8_t batch[SAMPLE_BYTES*BATCH_SAMPLES];
static unsigned buffered;

static int clock_metadata(void) { Cy_SysClk_EcoSetFrequency(17203200); return 0; }
SYS_INIT(clock_metadata,PRE_KERNEL_1,0);
static struct status snapshot(void)
{ k_mutex_lock(&lock,K_FOREVER); struct status v=state; k_mutex_unlock(&lock); return v; }
static void disk_publish(int error)
{
    struct store_status disk; store_snapshot(&disk);
    k_mutex_lock(&lock,K_FOREVER); state.disk=disk;
    if(error) state.error=error;
    k_mutex_unlock(&lock);
}
static void recording_set(bool on)
{ k_mutex_lock(&lock,K_FOREVER); state.recording=on; k_mutex_unlock(&lock); }
static void fail_recording(int error)
{
    recording_set(false); store_abort(); k_msgq_purge(&samples); buffered=0;
    disk_publish(error); printk("EVENT LOGGER STOPPED_ERROR rc=%d\n",error);
}
static void acquire(void *a,void *b,void *c)
{
    ARG_UNUSED(a); ARG_UNUSED(b); ARG_UNUSED(c);
    int64_t next=k_uptime_get();
    for(;;) {
        struct sensor_value av[3],gv[3],temp,press;
        k_mutex_lock(&acquisition_gate,K_FOREVER);
        int ret=device_is_ready(imu)&&device_is_ready(baro)?0:-ENODEV;
        if(!ret) ret=sensor_sample_fetch(imu);
        if(ret) printk("EVENT SENSOR_FAILED stage=imu rc=%d\n",ret);
        if(!ret) ret=sensor_channel_get(imu,SENSOR_CHAN_ACCEL_XYZ,av);
        if(!ret) ret=sensor_channel_get(imu,SENSOR_CHAN_GYRO_XYZ,gv);
        if(!ret) {
            ret=sensor_sample_fetch(baro);
            if(ret) printk("EVENT SENSOR_FAILED stage=baro rc=%d\n",ret);
        }
        if(!ret) ret=sensor_channel_get(baro,SENSOR_CHAN_AMBIENT_TEMP,&temp);
        if(!ret) ret=sensor_channel_get(baro,SENSOR_CHAN_PRESS,&press);
        k_mutex_unlock(&acquisition_gate);
        uint8_t packed[SAMPLE_BYTES]; uint64_t now=k_uptime_get(); int32_t v[8];
        if(!ret) {
            for(unsigned i=0;i<3;i++) {
                v[i]=sensor_value_to_micro(&av[i])/1000; /* milli m/s^2 */
                v[3+i]=sensor_value_to_micro(&gv[i])/1000; /* milli rad/s */
            }
            v[6]=sensor_value_to_micro(&temp)/1000; /* milli Celsius */
            v[7]=sensor_value_to_micro(&press)/1000; /* kPa -> Pa */
            sys_put_le64(now,packed);
            for(unsigned i=0;i<8;i++) sys_put_le32((uint32_t)v[i],packed+8+4*i);
        }
        k_mutex_lock(&lock,K_FOREVER);
        state.valid=!ret;
        if(ret) { state.errors++; if(state.recording) state.error=ret; }
        else {
            state.time_ms=now; state.acquired++; memcpy(state.values,v,sizeof(v));
            if(state.recording && k_msgq_put(&samples,packed,K_NO_WAIT)) {
                state.dropped++; state.error=-ENOBUFS;
            }
        }
        k_mutex_unlock(&lock);
        next+=100;
        int64_t delay=next-k_uptime_get();
        if(delay<0) { next=k_uptime_get(); delay=0; }
        k_msleep(delay);
    }
}
static int drain(bool flush)
{
    while(!k_msgq_get(&samples,batch+buffered*SAMPLE_BYTES,K_NO_WAIT)) {
        if(++buffered==BATCH_SAMPLES) {
            int ret=store_append(batch,buffered); if(ret) return ret;
            buffered=0; disk_publish(0);
        }
    }
    if(flush && buffered) {
        int ret=store_append(batch,buffered); if(ret) return ret;
        buffered=0; disk_publish(0);
    }
    return 0;
}
static void status_print(void)
{
    disk_publish(0); struct status v=snapshot();
    printk("OK STATUS mounted=%u key=%u recording=%u samples=%u batches=%u bytes=%u free=%u nonce=%llu name=%s acquired=%u errors=%u dropped=%u sensor=%u display=%u touch=%u renders=%u rc=%d\n",
        v.disk.mounted,v.disk.key_ready,v.recording,v.disk.samples,v.disk.batches,
        v.disk.bytes,v.disk.free_bytes,(unsigned long long)v.disk.nonce,
        v.disk.name[0]?v.disk.name:"-",v.acquired,v.errors,v.dropped,v.valid,
        v.display_ok,v.touch_ok,v.ui_frames,v.error);
}
static int parse_index(const char *text,unsigned *value)
{
    if(!text || !*text) return -EINVAL;
    for(const char *p=text;*p;p++) if(*p<'0'||*p>'9') return -EINVAL;
    char *end; unsigned long n=strtoul(text,&end,10);
    if(*end || n>100000) return -EINVAL;
    *value=n; return 0;
}
static void command(char *line)
{
    char *save=NULL,*args[6]; unsigned argc=0;
    for(char *p=strtok_r(line," ",&save);p;p=strtok_r(NULL," ",&save)) {
        if(argc==ARRAY_SIZE(args)) { printk("ERR COMMAND rc=%d\n",-EINVAL); return; }
        args[argc++]=p;
    }
    if(argc<2 || strcmp(args[0],"log")) { printk("ERR COMMAND rc=%d\n",-EINVAL); return; }
    const char *cmd=args[1]; int ret=-EINVAL; unsigned index=0; bool handled=false;
    struct status v=snapshot();
    if(!strcmp(cmd,"status") && argc==2) { status_print(); return; }
    if(!strcmp(cmd,"init-blank") && argc==2) {
        ret=store_init_blank();
        if(!ret) { k_mutex_lock(&lock,K_FOREVER); state.error=0; k_mutex_unlock(&lock); }
    }
    else if(!strcmp(cmd,"start") && argc==3) {
        char name[25]; const char *selected=args[2];
        if(!strcmp(selected,"auto")) {
            snprintk(name,sizeof(name),"r%016llx",(unsigned long long)(v.disk.nonce+1)); selected=name;
        }
        ret=v.recording?-EBUSY:!v.valid?-ENODEV:store_start(selected);
        if(!ret) {
            k_msgq_purge(&samples); buffered=0;
            k_mutex_lock(&lock,K_FOREVER); state.error=0; state.recording=true; k_mutex_unlock(&lock);
        }
    } else if(!strcmp(cmd,"stop") && argc==2) {
        ret=v.recording?0:-EALREADY;
        if(!ret) { recording_set(false); ret=drain(true); if(!ret) ret=store_stop(); }
        if(ret && ret!=-EALREADY) fail_recording(ret);
    } else if(!strcmp(cmd,"list") && argc==2) { ret=store_list(); handled=true; }
    else if((!strcmp(cmd,"read")||!strcmp(cmd,"verify")) && argc==3) {
        ret=store_read(args[2],!strcmp(cmd,"read")); handled=true;
    } else if(!strcmp(cmd,"delete") && argc==3) ret=store_delete(args[2]);
    else if(!strcmp(cmd,"raw") && argc==4 && !parse_index(args[3],&index)) {
        ret=store_raw(args[2],index); handled=true;
    } else if(!strcmp(cmd,"tamper") && argc==5 && !parse_index(args[3],&index))
        ret=store_tamper(args[2],index,args[4]);
    else if(!strcmp(cmd,"kat") && argc==2) ret=store_kat();
    else if(!strcmp(cmd,"reboot") && argc==2) {
        printk("OK REBOOT unsynced_data_may_be_lost=1\n"); k_msleep(50); sys_reboot(SYS_REBOOT_COLD); return;
    }
    disk_publish(0);
    if(ret) printk("ERR COMMAND cmd=%s rc=%d\n",cmd,ret);
    else if(!handled) printk("OK COMMAND cmd=%s\n",cmd);
}
static void storage(void *a,void *b,void *c)
{
    ARG_UNUSED(a); ARG_UNUSED(b); ARG_UNUSED(c);
    k_mutex_lock(&acquisition_gate,K_FOREVER);
    int ret=store_init(); disk_publish(ret);
    k_mutex_unlock(&acquisition_gate);
    printk("READY LOGGER version=1 storage_rc=%d\n",ret);
    char line[96];
    for(;;) {
        k_mutex_lock(&acquisition_gate,K_FOREVER);
        if(!k_msgq_get(&commands,line,K_NO_WAIT)) command(line);
        struct status v=snapshot();
        if(v.recording) {
            if(v.error) fail_recording(v.error);
            else { ret=drain(false); if(ret) fail_recording(ret); }
        }
        k_mutex_unlock(&acquisition_gate);
        k_msleep(5);
    }
}
static void submit(const char *text)
{
    char line[96]={0}; strncpy(line,text,sizeof(line)-1);
    if(k_msgq_put(&commands,line,K_NO_WAIT)) printk("ERR QUEUE rc=%d\n",-EBUSY);
}
static void button_click(lv_event_t *event)
{ submit(lv_event_get_user_data(event)); }
static lv_obj_t *label(lv_obj_t *parent,int x,int y,int width,const char *text,uint32_t color)
{
    lv_obj_t *o=lv_label_create(parent); lv_obj_set_pos(o,x,y); lv_obj_set_width(o,width);
    lv_obj_set_style_text_color(o,lv_color_hex(color),0);
    lv_obj_set_style_text_font(o,&lv_font_montserrat_20,0); lv_label_set_text(o,text); return o;
}
static lv_obj_t *card(int x,int y,int width,int height,const char *title)
{
    lv_obj_t *o=lv_obj_create(lv_screen_active()); lv_obj_set_pos(o,x,y); lv_obj_set_size(o,width,height);
    lv_obj_set_style_bg_color(o,lv_color_hex(0x13283b),0);
    lv_obj_set_style_border_color(o,lv_color_hex(0x25445e),0);
    lv_obj_set_style_pad_all(o,12,0); lv_obj_clear_flag(o,LV_OBJ_FLAG_SCROLLABLE);
    label(o,0,0,width-28,title,0x64cce3); return o;
}
static void button(int x,int width,const char *text,const char *cmd,uint32_t color)
{
    lv_obj_t *o=lv_button_create(lv_screen_active()); lv_obj_set_pos(o,x,414); lv_obj_set_size(o,width,48);
    lv_obj_set_style_bg_color(o,lv_color_hex(color),0);
    lv_obj_t *t=lv_label_create(o); lv_label_set_text(t,text); lv_obj_center(t);
    lv_obj_set_style_text_font(t,&lv_font_montserrat_20,0);
    lv_obj_add_event_cb(o,button_click,LV_EVENT_CLICKED,(void *)cmd);
}
static void create_ui(void)
{
    lv_obj_set_style_bg_color(lv_screen_active(),lv_color_hex(0x081420),0);
    label(lv_screen_active(),24,18,530,"SECURE SENSOR LOGGER / 026",0xffffff);
    label(lv_screen_active(),570,18,220,"AES-256-GCM",0x65efc0);
    lv_obj_t *top=card(24,60,752,105,"LIVE / 10 Hz / BMI270 + DPS368");
    mode_label=label(top,0,34,230,"INITIALIZING",0x65efc0);
    lv_obj_set_style_text_font(mode_label,&lv_font_montserrat_28,0);
    count_label=label(top,250,34,470,"Waiting for storage",0xffffff);
    lv_obj_t *left=card(24,180,365,93,"ACCELEROMETER / milli m/s2");
    acc_label=label(left,0,32,335,"--",0xffffff);
    lv_obj_t *right=card(405,180,371,93,"GYROSCOPE / milli rad/s");
    gyro_label=label(right,0,32,341,"--",0xffffff);
    left=card(24,285,365,90,"ENVIRONMENT"); env_label=label(left,0,32,335,"--",0xffffff);
    right=card(405,285,371,90,"ENCRYPTED STORAGE"); space_label=label(right,0,32,341,"--",0xffffff);
    note_label=label(lv_screen_active(),24,381,750,"Persistent TF-M key / authenticated record chain",0x83a4ba);
    button(24,237,"RECORD","log start auto",0x087b64);
    button(281,237,"STOP + SAVE","log stop",0x256fa2);
    button(538,238,"STATUS","log status",0x334a61);
}
static void update_ui(void)
{
    struct status v=snapshot(); char text[100];
    lv_label_set_text(mode_label,v.recording?"RECORDING":v.error?"CHECK STATUS":"READY");
    snprintk(text,sizeof(text),"%u samples / %u batches\n%s",v.disk.samples,v.disk.batches,
             v.disk.name[0]?v.disk.name:"No active recording"); lv_label_set_text(count_label,text);
    snprintk(text,sizeof(text),"X %d   Y %d   Z %d",v.values[0],v.values[1],v.values[2]); lv_label_set_text(acc_label,text);
    snprintk(text,sizeof(text),"X %d   Y %d   Z %d",v.values[3],v.values[4],v.values[5]); lv_label_set_text(gyro_label,text);
    snprintk(text,sizeof(text),"%d.%02d C    %d Pa",v.values[6]/1000,abs(v.values[6]%1000)/10,v.values[7]); lv_label_set_text(env_label,text);
    snprintk(text,sizeof(text),"%u KiB free / %u B saved",v.disk.free_bytes/1024,v.disk.bytes); lv_label_set_text(space_label,text);
    if(!v.disk.mounted) lv_label_set_text(note_label,"Storage unavailable: UART log init-blank only on erased partition");
    else if(v.error) { snprintk(text,sizeof(text),"Error %d / drops %u / sensor errors %u",v.error,v.dropped,v.errors); lv_label_set_text(note_label,text); }
    else lv_label_set_text(note_label,"TF-M key protected / STOP seals recording / UART exports verified data");
    k_mutex_lock(&lock,K_FOREVER); state.ui_frames++; k_mutex_unlock(&lock);
}
int main(void)
{
    const struct device *uart=DEVICE_DT_GET(DT_CHOSEN(zephyr_console));
    if(!device_is_ready(display)) { printk("FAIL LOGGER DISPLAY_DEVICE\n"); return 1; }
    int ret=lvgl_init(); if(ret) { printk("FAIL LOGGER LVGL rc=%d\n",ret); return 1; }
    ret=ft5406_init(); state.touch_ok=!ret;
    if(!ret) ft5406_lvgl_register();
    create_ui(); lv_refr_now(NULL); display_blanking_off(display);
    const struct sensor_value hz={.val1=100};
    if(!device_is_ready(imu) || !device_is_ready(baro)) {
        printk("FAIL LOGGER SENSOR_DEVICE\n"); return 1;
    }
    ret=sensor_attr_set(imu,SENSOR_CHAN_ACCEL_XYZ,SENSOR_ATTR_SAMPLING_FREQUENCY,&hz);
    if(!ret) ret=sensor_attr_set(imu,SENSOR_CHAN_GYRO_XYZ,SENSOR_ATTR_SAMPLING_FREQUENCY,&hz);
    if(ret) { printk("FAIL LOGGER SENSOR_ODR rc=%d\n",ret); return 1; }
    /* Report startup before the storage worker can print concurrently. */
    struct waveshare_status initial;
    k_msleep(100);
    ret=waveshare_get_status(display,&initial);
    if(ret) { printk("FAIL LOGGER DISPLAY_HEALTH rc=%d\n",ret); return 1; }
    state.display_ok=true;
    printk("OK DISPLAY INITIALIZATION_SUCCESS frames=%u clock=%u dsi0=%x dsi1=%x dc=%x touch=%u\n",
        initial.frames,initial.clock_hz,initial.dsi_errors0,initial.dsi_errors1,initial.dc_errors,state.touch_ok);
    k_thread_priority_set(k_current_get(),5);
    k_thread_create(&sensor_thread,sensor_stack,K_THREAD_STACK_SIZEOF(sensor_stack),acquire,NULL,NULL,NULL,3,0,K_NO_WAIT);
    k_thread_create(&storage_thread,storage_stack,K_THREAD_STACK_SIZEOF(storage_stack),storage,NULL,NULL,NULL,6,0,K_NO_WAIT);
    char line[96]; size_t used=0; bool overflow=false; int64_t next=0;
    for(;;) {
        k_mutex_lock(&acquisition_gate,K_FOREVER);
        if(state.touch_ok) ft5406_poll();
        k_mutex_unlock(&acquisition_gate);
        if(k_uptime_get()>=next) {
            update_ui(); next=k_uptime_get()+200;
            struct waveshare_status d;
            k_mutex_lock(&acquisition_gate,K_FOREVER);
            ret=waveshare_get_status(display,&d);
            k_mutex_unlock(&acquisition_gate);
            k_mutex_lock(&lock,K_FOREVER); state.display_ok=!ret; k_mutex_unlock(&lock);
        }
        unsigned char ch;
        while(!uart_poll_in(uart,&ch)) {
            if(ch=='\n'||ch=='\r') {
                if(overflow) printk("ERR COMMAND_TOO_LONG\n");
                else if(used) { line[used]=0; submit(line); }
                used=0; overflow=false;
            } else if(used<sizeof(line)-1) line[used++]=ch;
            else overflow=true;
        }
        lv_timer_handler(); k_msleep(3);
    }
}
```

## src/store.c
```c
/* Educational streaming AEAD. Filenames/lengths remain public. UART is trusted.
 * No export permission on the persistent key. No guarantee against replay of
 * a complete old file, physical debug access, or malicious file deletion.
 */
#include "store.h"
#include <errno.h>
#include <string.h>
#include <psa/crypto.h>
#include <psa/protected_storage.h>
#include <zephyr/fs/fs.h>
#include <zephyr/fs/littlefs.h>
#include <zephyr/drivers/flash.h>
#include <zephyr/storage/flash_map.h>
#include <zephyr/sys/byteorder.h>
#include <zephyr/sys/printk.h>

#define KEY_ID 0x2601
#define COUNTER_UID 0x534c4701ULL
#define HEADER 64
#define TAG 16
#define PAYLOAD (SAMPLE_BYTES * BATCH_SAMPLES)
#define NONCE_RESERVATION 64
FS_LITTLEFS_DECLARE_DEFAULT_CONFIG(lfs);
static struct fs_mount_t mountp = {
    .type=FS_LITTLEFS, .fs_data=&lfs,
    .storage_dev=(void *)PARTITION_ID(logger_partition),
    .mnt_point="/log", .flags=FS_MOUNT_FLAG_NO_FORMAT,
};
static const struct flash_area *area;
static struct store_status s;
static struct fs_file_t output;
static uint64_t reserved;
static uint8_t previous[TAG];
static uint8_t record[HEADER + PAYLOAD + TAG], plain[PAYLOAD], aad[HEADER + LOG_NAME_MAX];

static void wipe(void *p, size_t n)
{ volatile uint8_t *v=p; while(n--) *v++=0; }
static void hex_out(const uint8_t *p, size_t n)
{ while(n--) printk("%02x",*p++); }
bool store_name_valid(const char *name)
{
    if(!name || !*name || strlen(name)>LOG_NAME_MAX) return false;
    for(const char *p=name;*p;p++)
        if(!((*p>='a'&&*p<='z')||(*p>='A'&&*p<='Z')||
             (*p>='0'&&*p<='9')||*p=='_'||*p=='-')) return false;
    return true;
}
static void path(char out[32], const char *name)
{ snprintk(out,32,"/log/%s",name); }
static void attr_set(psa_key_attributes_t *attr, bool persistent)
{
    psa_set_key_type(attr,PSA_KEY_TYPE_AES);
    psa_set_key_bits(attr,256);
    psa_set_key_algorithm(attr,PSA_ALG_GCM);
    psa_set_key_usage_flags(attr,PSA_KEY_USAGE_ENCRYPT|PSA_KEY_USAGE_DECRYPT);
    if(persistent) {
        psa_set_key_lifetime(attr,PSA_KEY_LIFETIME_PERSISTENT);
        psa_set_key_id(attr,KEY_ID);
    }
}
static int key_init(void)
{
    psa_key_attributes_t attr=PSA_KEY_ATTRIBUTES_INIT;
    uint8_t state[8]; size_t length=0;
    psa_status_t ks=psa_get_key_attributes(KEY_ID,&attr);
    psa_status_t cs=psa_ps_get(COUNTER_UID,0,sizeof(state),state,&length);
    printk("DETAIL LOGGER KEY=%d COUNTER=%d length=%zu\n",ks,cs,length);
    if(ks==PSA_SUCCESS) {
        bool valid=psa_get_key_type(&attr)==PSA_KEY_TYPE_AES &&
            psa_get_key_bits(&attr)==256 && psa_get_key_algorithm(&attr)==PSA_ALG_GCM &&
            psa_get_key_usage_flags(&attr)==(PSA_KEY_USAGE_ENCRYPT|PSA_KEY_USAGE_DECRYPT);
        psa_reset_key_attributes(&attr);
        if(!valid || cs!=PSA_SUCCESS || length!=8) return -EKEYREJECTED;
        s.nonce=reserved=sys_get_le64(state); /* skip all unused reservations on boot */
        return 0;
    }
    psa_reset_key_attributes(&attr);
    if((ks!=PSA_ERROR_DOES_NOT_EXIST && ks!=PSA_ERROR_INVALID_HANDLE)||
        cs!=PSA_ERROR_DOES_NOT_EXIST) return -EKEYREJECTED;
    memset(state,0,sizeof(state));
    if(psa_ps_set(COUNTER_UID,8,state,PSA_STORAGE_FLAG_NONE)!=PSA_SUCCESS) return -EIO;
    attr_set(&attr,true); psa_key_id_t id;
    ks=psa_generate_key(&attr,&id); psa_reset_key_attributes(&attr);
    return ks==PSA_SUCCESS ? 0 : -EIO;
}
static int nonce_next(uint8_t nonce[12])
{
    if(!s.key_ready) return -EKEYREJECTED;
    if(s.nonce==reserved) {
        if(reserved>UINT64_MAX-NONCE_RESERVATION) return -EOVERFLOW;
        uint8_t state[8]; uint64_t next=reserved+NONCE_RESERVATION;
        sys_put_le64(next,state);
        if(psa_ps_set(COUNTER_UID,8,state,PSA_STORAGE_FLAG_NONE)!=PSA_SUCCESS) {
            s.key_ready=false; return -EIO;
        }
        reserved=next;
    }
    sys_put_le32(KEY_ID,nonce); sys_put_le64(++s.nonce,nonce+4);
    return 0;
}
static void space_update(void)
{
    struct fs_statvfs v;
    if(s.mounted && !fs_statvfs("/log",&v)) s.free_bytes=v.f_bfree*v.f_frsize;
}
void store_snapshot(struct store_status *out) { *out=s; }
int store_init(void)
{
    int ret=flash_area_open(PARTITION_ID(logger_partition),&area);
    if(ret) return ret;
    struct flash_pages_info page={0};
    ret=flash_get_page_info_by_offs(area->fa_dev,area->fa_off,&page);
    printk("DETAIL LOGGER FLASH offset=%lx size=%lx sector=%lx rc=%d\n",
        (unsigned long)area->fa_off,(unsigned long)area->fa_size,(unsigned long)page.size,ret);
    if(ret || area->fa_off!=0x1780000 || area->fa_size!=0x300000 || page.size!=0x40000)
        return -EINVAL;
    ret=psa_crypto_init(); if(ret) return -EIO;
    ret=key_init(); if(ret) return ret;
    s.key_ready=true;
    ret=fs_mount(&mountp);
    if(!ret) s.mounted=true;
    space_update();
    return ret;
}
int store_init_blank(void)
{
    if(s.mounted) return 0;
    if(!area || !s.key_ready) return -ENODEV;
    uint8_t bytes[256];
    for(off_t offset=0;offset<area->fa_size;offset+=sizeof(bytes)) {
        int ret=flash_area_read(area,offset,bytes,sizeof(bytes)); if(ret) return ret;
        for(size_t i=0;i<sizeof(bytes);i++) if(bytes[i]!=0xff) {
            printk("DETAIL INIT NONBLANK flash_offset=%lx; no erase performed\n",
                   (unsigned long)(area->fa_off+offset+i));
            return -EEXIST;
        }
    }
    int ret=fs_mkfs(FS_LITTLEFS,(uintptr_t)PARTITION_ID(logger_partition),NULL,0);
    if(!ret) ret=fs_mount(&mountp);
    if(!ret) s.mounted=true;
    space_update(); return ret;
}
static void aad_make(const char *name)
{
    memcpy(aad,record,HEADER); memset(aad+HEADER,0,LOG_NAME_MAX);
    memcpy(aad+HEADER,name,strlen(name));
}
int store_start(const char *name)
{
    if(!s.mounted || !s.key_ready) return -ENODEV;
    if(s.opened) return -EBUSY;
    if(!store_name_valid(name)) return -EINVAL;
    char file[32]; path(file,name); struct fs_dirent entry;
    int ret=fs_stat(file,&entry);
    if(!ret) return -EEXIST;
    if(ret!=-ENOENT) return ret;
    uint8_t nonce[12]; ret=nonce_next(nonce); if(ret) return ret;
    fs_file_t_init(&output);
    ret=fs_open(&output,file,FS_O_CREATE|FS_O_WRITE); if(ret) return ret;
    s.opened=true; s.samples=s.batches=s.bytes=0;
    s.session=sys_get_le64(nonce+4); strcpy(s.name,name); memset(previous,0,TAG);
    return 0;
}
static int append_record(const uint8_t *data, unsigned count, bool seal)
{
    if(!s.opened) return -EBADF;
    unsigned length=seal?8:count*SAMPLE_BYTES;
    if(!seal && (!count || count>BATCH_SAMPLES)) return -EINVAL;
    memset(record,0,HEADER); memcpy(record,"SLG1",4);
    record[4]=1; record[5]=seal?2:1;
    sys_put_le16(count,record+6); sys_put_le32(length,record+8);
    sys_put_le32(s.batches,record+12); sys_put_le64(s.session,record+16);
    int ret=nonce_next(record+24); if(ret) return ret;
    sys_put_le32(KEY_ID,record+36); memcpy(record+40,previous,TAG);
    aad_make(s.name); size_t encrypted=0;
    psa_status_t status=psa_aead_encrypt(KEY_ID,PSA_ALG_GCM,record+24,12,
        aad,sizeof(aad),data,length,record+HEADER,PAYLOAD+TAG,&encrypted);
    if(status!=PSA_SUCCESS || encrypted!=length+TAG) return -EIO;
    ssize_t written=fs_write(&output,record,HEADER+encrypted);
    if(written!=(ssize_t)(HEADER+encrypted)) return written<0?written:-EIO;
    ret=fs_sync(&output); if(ret) return ret;
    memcpy(previous,record+HEADER+length,TAG); s.bytes+=HEADER+encrypted;
    if(!seal) { s.batches++; s.samples+=count; }
    space_update(); return 0;
}
int store_append(const uint8_t *samples, unsigned count)
{ return append_record(samples,count,false); }
void store_abort(void)
{
    if(s.opened) fs_close(&output);
    s.opened=false; wipe(plain,sizeof(plain)); space_update();
}
int store_stop(void)
{
    uint8_t totals[8]; sys_put_le32(s.samples,totals); sys_put_le32(s.batches,totals+4);
    int ret=append_record(totals,0,true);
    int closed=s.opened?fs_close(&output):0; s.opened=false; space_update();
    return ret?ret:closed;
}

/* Returns 1 for a whole record, 0 for EOF, 2 for a torn final record. All
 * full records must authenticate. Never mistake an invalid tag for a reset.
 */
static int record_read(struct fs_file_t *f, unsigned *length)
{
    ssize_t n=fs_read(f,record,HEADER);
    if(n<0) return n;
    if(!n) return 0;
    if(n!=HEADER) return 2;
    if(memcmp(record,"SLG1",4)||record[4]!=1||
       (record[5]!=1 && record[5]!=2)||sys_get_le32(record+36)!=KEY_ID ||
       memcmp(record+24,record+36,4)) return -EBADMSG;
    for(unsigned i=56;i<64;i++) if(record[i]) return -EBADMSG;
    *length=sys_get_le32(record+8); unsigned count=sys_get_le16(record+6);
    if((record[5]==1 && (!count||count>BATCH_SAMPLES||*length!=count*SAMPLE_BYTES)) ||
       (record[5]==2 && (count||*length!=8))) return -EBADMSG;
    n=fs_read(f,record+HEADER,*length+TAG);
    if(n<0) return n;
    return n==*length+TAG?1:2;
}
static int decrypt_record(const char *name, unsigned length)
{
    aad_make(name); size_t n=0;
    psa_status_t ret=psa_aead_decrypt(KEY_ID,PSA_ALG_GCM,record+24,12,
        aad,sizeof(aad),record+HEADER,length+TAG,plain,sizeof(plain),&n);
    if(ret!=PSA_SUCCESS || n!=length) { wipe(plain,sizeof(plain)); return -EBADMSG; }
    return 0;
}
static int scan(const char *name, bool emit, bool report)
{
    char file[32]; path(file,name); struct fs_file_t f; fs_file_t_init(&f);
    int ret=fs_open(&f,file,FS_O_READ); if(ret) return ret;
    uint32_t batches=0,samples=0; uint64_t session=0,last_nonce=0;
    uint8_t prev[TAG]={0}; bool sealed=false,torn=false;
    for(;;) {
        unsigned length=0; ret=record_read(&f,&length);
        if(ret==0) break;
        if(sealed) { ret=-EBADMSG; break; }
        if(ret==2) { torn=true; ret=0; break; }
        if(ret<0) break;
        ret=decrypt_record(name,length); if(ret) break;
        uint64_t id=sys_get_le64(record+16), nonce=sys_get_le64(record+28);
        if(!batches) session=id;
        if(!session || id!=session || nonce<=last_nonce || nonce<=session ||
           sys_get_le32(record+12)!=batches || memcmp(prev,record+40,TAG)) {
            ret=-EBADMSG; break;
        }
        last_nonce=nonce; memcpy(prev,record+HEADER+length,TAG);
        if(record[5]==2) {
            if(sys_get_le32(plain)!=samples || sys_get_le32(plain+4)!=batches) {
                ret=-EBADMSG; break;
            }
            sealed=true;
        } else {
            unsigned count=sys_get_le16(record+6);
            for(unsigned i=0;emit && i<count;i++) {
                const uint8_t *p=plain+i*SAMPLE_BYTES;
                printk("ROW %llu",(unsigned long long)sys_get_le64(p));
                for(unsigned j=8;j<SAMPLE_BYTES;j+=4) printk(",%d",(int32_t)sys_get_le32(p+j));
                printk("\n");
            }
            samples+=count; batches++;
        }
        wipe(plain,sizeof(plain));
    }
    wipe(plain,sizeof(plain)); int closed=fs_close(&f);
    if(ret>=0) ret=closed;
    if(!ret && report) printk("OK READ name=%s samples=%u batches=%u sealed=%u torn=%u session=%llu\n",
        name,samples,batches,sealed,torn,(unsigned long long)session);
    return ret;
}
int store_read(const char *name, bool emit)
{
    if(!store_name_valid(name)) return -EINVAL;
    if(s.opened) return -EBUSY;
    /* No plaintext is released until the entire visible file passes preflight.
     * Single storage owner means file cannot change between these two passes. */
    int ret=scan(name,false,false);
    return ret?ret:scan(name,emit,true);
}
int store_delete(const char *name)
{
    if(!store_name_valid(name)) return -EINVAL;
    if(s.opened) return -EBUSY;
    char file[32]; path(file,name); int ret=fs_unlink(file); space_update(); return ret;
}
int store_list(void)
{
    if(!s.mounted) return -ENODEV;
    struct fs_dir_t dir; fs_dir_t_init(&dir); int ret=fs_opendir(&dir,"/log"); if(ret) return ret;
    struct fs_dirent entry; unsigned count=0;
    while(!(ret=fs_readdir(&dir,&entry)) && entry.name[0]) {
        printk("FILE name=%s bytes=%zu\n",entry.name,entry.size); count++;
    }
    int close_ret=fs_closedir(&dir); if(!ret) ret=close_ret;
    if(!ret) printk("OK LIST count=%u\n",count);
    return ret;
}
static int locate(struct fs_file_t *f, const char *name, unsigned index, unsigned *length)
{
    if(!store_name_valid(name)||index>100000) return -EINVAL;
    if(s.opened) return -EBUSY;
    char file[32]; path(file,name); fs_file_t_init(f);
    int ret=fs_open(f,file,FS_O_READ|FS_O_WRITE); if(ret) return ret;
    for(unsigned i=0;i<=index;i++) {
        ret=record_read(f,length);
        if(ret!=1) { fs_close(f); return ret<0?ret:-ENOENT; }
    }
    return 0;
}
int store_raw(const char *name, unsigned index)
{
    struct fs_file_t f; unsigned length; int ret=locate(&f,name,index,&length); if(ret) return ret;
    ret=fs_close(&f);
    if(!ret) { printk("OK RAW hex="); hex_out(record,HEADER+length+TAG); printk("\n"); }
    return ret;
}
int store_tamper(const char *name, unsigned index, const char *part)
{
    if(strcmp(part,"header")&&strcmp(part,"data")&&strcmp(part,"tag")) return -EINVAL;
    struct fs_file_t f; unsigned length; int ret=locate(&f,name,index,&length); if(ret) return ret;
    unsigned pos=!strcmp(part,"header")?16:!strcmp(part,"data")?HEADER:HEADER+length;
    off_t start=fs_tell(&f)-(HEADER+length+TAG);
    record[pos]^=1;
    ret=fs_seek(&f,start+pos,FS_SEEK_SET);
    if(!ret && fs_write(&f,record+pos,1)!=1) ret=-EIO;
    if(!ret) ret=fs_sync(&f);
    int closed=fs_close(&f); return ret?ret:closed;
}
int store_kat(void)
{
    uint8_t key[32],nonce[12],input[32],cipher[48],decoded[32];
    /* CM33's secure service must receive RAM-backed inputs, not M55 XIP
     * aliases that are outside the CM33 non-secure caller memory window. */
    uint8_t kat_aad[10]="SLG-KAT-v1";
    for(unsigned i=0;i<32;i++) { key[i]=i; input[i]=0x80+i; }
    for(unsigned i=0;i<12;i++) nonce[i]=i;
    psa_key_attributes_t attr=PSA_KEY_ATTRIBUTES_INIT; attr_set(&attr,false);
    psa_key_id_t id; psa_status_t ret=psa_import_key(&attr,key,32,&id);
    psa_reset_key_attributes(&attr); wipe(key,32); if(ret) return -EIO;
    size_t n=0;
    ret=psa_aead_encrypt(id,PSA_ALG_GCM,nonce,12,kat_aad,sizeof(kat_aad),
        input,32,cipher,48,&n);
    if(!ret) { printk("DETAIL KAT hex="); hex_out(cipher,n); printk("\n"); }
    if(!ret) ret=psa_aead_decrypt(id,PSA_ALG_GCM,nonce,12,kat_aad,sizeof(kat_aad),
        cipher,n,decoded,32,&n);
    if(!ret && (n!=32 || memcmp(input,decoded,32))) ret=PSA_ERROR_CORRUPTION_DETECTED;
    psa_status_t destroyed=psa_destroy_key(id); wipe(decoded,32);
    if(ret || destroyed) return -EIO;
    /* A different volatile key must reject the same authentic ciphertext. */
    memset(key,0xff,sizeof(key)); attr_set(&attr,false);
    ret=psa_import_key(&attr,key,sizeof(key),&id);
    psa_reset_key_attributes(&attr); wipe(key,sizeof(key));
    if(ret) return -EIO;
    ret=psa_aead_decrypt(id,PSA_ALG_GCM,nonce,12,kat_aad,sizeof(kat_aad),
        cipher,sizeof(cipher),decoded,sizeof(decoded),&n);
    destroyed=psa_destroy_key(id); wipe(decoded,sizeof(decoded));
    if(ret!=PSA_ERROR_INVALID_SIGNATURE || destroyed) return -EIO;
    ret=psa_export_key(KEY_ID,key,sizeof(key),&n); wipe(key,sizeof(key));
    if(ret!=PSA_ERROR_NOT_PERMITTED) return -EACCES;
    printk("DETAIL KAT wrong_key_rejected=1 persistent_key_export_denied=1\n");
    return 0;
}
```

## src/store.h
```c
/* All storage/PSA functions belong to the single storage worker. */
#ifndef LOGGER_STORE_H
#define LOGGER_STORE_H
#include <stdint.h>
#include <stdbool.h>
#define SAMPLE_BYTES 40
#define BATCH_SAMPLES 16
#define LOG_NAME_MAX 24
struct store_status {
    bool mounted, key_ready, opened;
    uint32_t samples, batches, bytes, free_bytes;
    uint64_t nonce, session;
    char name[LOG_NAME_MAX + 1];
};
int store_init(void);
int store_init_blank(void);
int store_start(const char *name);
int store_append(const uint8_t *samples, unsigned count);
int store_stop(void);
void store_abort(void);
void store_snapshot(struct store_status *out);
bool store_name_valid(const char *name);
int store_read(const char *name, bool emit);
int store_delete(const char *name);
int store_list(void);
int store_raw(const char *name, unsigned index);
int store_tamper(const char *name, unsigned index, const char *part);
int store_kat(void);
#endif
```
