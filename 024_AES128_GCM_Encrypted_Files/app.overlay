/* Separate 1 MiB data area; leave storage@0 and all firmware slots intact. */
&flash0 {
    partitions {
        encrypted_partition: partition@e00000 {
            compatible = "zephyr,mapped-partition";
            label = "encrypted-2";
            reg = <0xe00000 0x100000>;
        };
    };
};
