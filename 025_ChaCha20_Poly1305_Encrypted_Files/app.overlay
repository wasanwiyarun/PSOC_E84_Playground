/* Separate 1 MiB data area; leave storage@0 and all firmware slots intact. */
&flash0 {
    partitions {
        encrypted_partition: partition@f00000 {
            compatible = "zephyr,mapped-partition";
            label = "encrypted-3";
            reg = <0xf00000 0x100000>;
        };
    };
};
